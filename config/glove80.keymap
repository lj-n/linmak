/*
 * Copyright (c) 2020 The ZMK Contributors
 * Copyright (c) 2025 Innaworks Development Limited, trading as MoErgo
 *
 * SPDX-License-Identifier: MIT
 */

/* linmak — bilingual (German/English) Glove80 layout
 * Alphas: Aptmak Blue (https://sites.google.com/view/keyboards/layout/aptmak-blue), mirrored aptmak
 * Base:   TailorKey v5.2 Bilateral (https://sites.google.com/view/tailorkey)
 * Umlauts/ß via the EurKEY OS layout (AltGr). Originally exported from the MoErgo Layout Editor.
 */


/* THIS FILE WAS GENERATED BY GLOVE80 LAYOUT EDITOR
 *
 * This file was generated automatically. You may or may not want to
 * edit it directly.
 */

#include <behaviors.dtsi>
/* Include all behavior includes needed */
#include <dt-bindings/zmk/outputs.h>
#include <dt-bindings/zmk/keys.h>
#include <dt-bindings/zmk/bt.h>
#include <dt-bindings/zmk/rgb.h>

/* On demand includes */
#include <dt-bindings/zmk/input_transform.h>
#include <dt-bindings/zmk/pointing.h>
#include <input/processors.dtsi>

/* Helper Macros, based on https://github.com/urob/zmk-helpers/ */

#pragma once

#define ZMK_HELPER_STRINGIFY(x) #x

// Preprocessor mechanism to overload macros, cf. https://stackoverflow.com/a/27051616/6114651
#define VARGS_(_10, _9, _8, _7, _6, _5, _4, _3, _2, _1, N, ...) N
#define VARGS(...) VARGS_(__VA_ARGS__, 10, 9, 8, 7, 6, 5, 4, 3, 2, 1, 0)
#define CONCAT_(a, b) a##b
#define CONCAT(a, b) CONCAT_(a, b)

#define ZMK_BEHAVIOR_CORE_tap_dance  \
    compatible = "zmk,behavior-tap-dance"; \
    #binding-cells = <0>

#define ZMK_BEHAVIOR(name, type, ...) \
    name: name { \
        ZMK_BEHAVIOR_CORE_ ## type; \
        __VA_ARGS__ \
    };

#define ZMK_TAP_DANCE(name, ...) \
    ZMK_BEHAVIOR(name, tap_dance, __VA_ARGS__)

#define ZMK_TD_LAYER(name, layer) \
    ZMK_TAP_DANCE(name, \
        tapping-term-ms = <200>; \
        bindings = <&mo layer>, <&to layer>; \
)

/* Environment and metadata defines */
#define KB_TYPE_GLOVE_80 1
#define KB_TYPE_GO_60    2

#define KB_TYPE          KB_TYPE_GLOVE_80
#define EDITOR_HOST_OS   'M'

/* Automatically generated layer name defines */
#define LAYER_Base 0
#define LAYER_Typing 1
#define LAYER_LeftPinky 2
#define LAYER_LeftRingy 3
#define LAYER_LeftMiddy 4
#define LAYER_LeftIndex 5
#define LAYER_RightIndex 6
#define LAYER_RightMiddy 7
#define LAYER_RightRingy 8
#define LAYER_RightPinky 9
#define LAYER_Cursor 10
#define LAYER_Symbol 11
#define LAYER_Mouse 12
#define LAYER_MouseSlow 13
#define LAYER_MouseFast 14
#define LAYER_MouseWarp 15
#define LAYER_Magic 16
#define LAYER_Numbers 17
#define LAYER_Function 18
#define LAYER_Gaming 19
#define LAYER_Aerospace 20

/* To deal with the situation where there is no Lower layer, to keep &lower happy */
#ifndef LAYER_Lower
#define LAYER_Lower 0
#endif

/* Custom Device-tree */


/* Input Listeners */
&mmv_input_listener {
    // LAYER_MouseSlow
    LAYER_MouseSlow {
        layers = <LAYER_MouseSlow>;
        input-processors = <&zip_xy_scaler 1 9>;
    };
    // LAYER_MouseFast
    LAYER_MouseFast {
        layers = <LAYER_MouseFast>;
        input-processors = <&zip_xy_scaler 3 1>;
    };
    // LAYER_MouseWarp
    LAYER_MouseWarp {
        layers = <LAYER_MouseWarp>;
        input-processors = <&zip_xy_scaler 12 1>;
    };
};

&msc_input_listener {
    // LAYER_MouseSlow
    LAYER_MouseSlow {
        layers = <LAYER_MouseSlow>;
        input-processors = <&zip_scroll_scaler 1 9>;
    };
    // LAYER_MouseFast
    LAYER_MouseFast {
        layers = <LAYER_MouseFast>;
        input-processors = <&zip_scroll_scaler 3 1>;
    };
    // LAYER_MouseWarp
    LAYER_MouseWarp {
        layers = <LAYER_MouseWarp>;
        input-processors = <&zip_scroll_scaler 12 1>;
    };
};

/* System behavior and Macros */
/ {
    behaviors {
        ZMK_TD_LAYER(lower, LAYER_Lower)
    };
};

/ {
    macros {
        rgb_ug_status_macro: rgb_ug_status_macro {
            label = "RGB_UG_STATUS";
            compatible = "zmk,behavior-macro";
            #binding-cells = <0>;
            bindings
                = <&rgb_ug RGB_STATUS>;
        };
    };
};


/ {
#ifdef BT_DISC_CMD
    behaviors {
        bt_0: bt_0 {
            compatible = "zmk,behavior-tap-dance";
            label = "BT_0";
            #binding-cells = <0>;
            tapping-term-ms = <200>;
            bindings = <&bt_select_0>, <&bt BT_DISC 0>;
        };
        bt_1: bt_1 {
            compatible = "zmk,behavior-tap-dance";
            label = "BT_1";
            #binding-cells = <0>;
            tapping-term-ms = <200>;
            bindings = <&bt_select_1>, <&bt BT_DISC 1>;
        };
        bt_2: bt_2 {
            compatible = "zmk,behavior-tap-dance";
            label = "BT_2";
            #binding-cells = <0>;
            tapping-term-ms = <200>;
            bindings = <&bt_select_2>, <&bt BT_DISC 2>;
        };
        bt_3: bt_3 {
            compatible = "zmk,behavior-tap-dance";
            label = "BT_3";
            #binding-cells = <0>;
            tapping-term-ms = <200>;
            bindings = <&bt_select_3>, <&bt BT_DISC 3>;
        };
    };
    macros {
        bt_select_0: bt_select_0 {
            label = "BT_SELECT_0";
            compatible = "zmk,behavior-macro";
            #binding-cells = <0>;
            bindings
                = <&out OUT_BLE>,
                  <&bt BT_SEL 0>;
        };
        bt_select_1: bt_select_1 {
            label = "BT_SELECT_1";
            compatible = "zmk,behavior-macro";
            #binding-cells = <0>;
            bindings
                = <&out OUT_BLE>,
                  <&bt BT_SEL 1>;
        };
        bt_select_2: bt_select_2 {
            label = "BT_SELECT_2";
            compatible = "zmk,behavior-macro";
            #binding-cells = <0>;
            bindings
                = <&out OUT_BLE>,
                  <&bt BT_SEL 2>;
        };
        bt_select_3: bt_select_3 {
            label = "BT_SELECT_3";
            compatible = "zmk,behavior-macro";
            #binding-cells = <0>;
            bindings
                = <&out OUT_BLE>,
                  <&bt BT_SEL 3>;
        };
    };
#else
    macros {
        bt_0: bt_0 {
            label = "BT_0";
            compatible = "zmk,behavior-macro";
            #binding-cells = <0>;
            bindings
                = <&out OUT_BLE>,
                  <&bt BT_SEL 0>;
        };
        bt_1: bt_1 {
            label = "BT_1";
            compatible = "zmk,behavior-macro";
            #binding-cells = <0>;
            bindings
                = <&out OUT_BLE>,
                  <&bt BT_SEL 1>;
        };
        bt_2: bt_2 {
            label = "BT_2";
            compatible = "zmk,behavior-macro";
            #binding-cells = <0>;
            bindings
                = <&out OUT_BLE>,
                  <&bt BT_SEL 2>;
        };
        bt_3: bt_3 {
            label = "BT_3";
            compatible = "zmk,behavior-macro";
            #binding-cells = <0>;
            bindings
                = <&out OUT_BLE>,
                  <&bt BT_SEL 3>;
        };
    };
#endif
};

/ {
    behaviors {
        magic: magic {
            compatible = "zmk,behavior-hold-tap";
            label = "MAGIC_HOLD_TAP";
            #binding-cells = <2>;
            flavor = "tap-preferred";
            tapping-term-ms = <200>;
            bindings = <&mo>, <&rgb_ug_status_macro>;
        };
    };
};


/* Key positions */

#define POS_LH_C6R1 0
#define POS_LH_C5R1 1
#define POS_LH_C4R1 2
#define POS_LH_C3R1 3
#define POS_LH_C2R1 4
#define POS_RH_C2R1 5
#define POS_RH_C3R1 6
#define POS_RH_C4R1 7
#define POS_RH_C5R1 8
#define POS_RH_C6R1 9
#define POS_LH_C6R2 10
#define POS_LH_C5R2 11
#define POS_LH_C4R2 12
#define POS_LH_C3R2 13
#define POS_LH_C2R2 14
#define POS_LH_C1R2 15
#define POS_RH_C1R2 16
#define POS_RH_C2R2 17
#define POS_RH_C3R2 18
#define POS_RH_C4R2 19
#define POS_RH_C5R2 20
#define POS_RH_C6R2 21
#define POS_LH_C6R3 22
#define POS_LH_C5R3 23
#define POS_LH_C4R3 24
#define POS_LH_C3R3 25
#define POS_LH_C2R3 26
#define POS_LH_C1R3 27
#define POS_RH_C1R3 28
#define POS_RH_C2R3 29
#define POS_RH_C3R3 30
#define POS_RH_C4R3 31
#define POS_RH_C5R3 32
#define POS_RH_C6R3 33
#define POS_LH_C6R4 34
#define POS_LH_C5R4 35
#define POS_LH_C4R4 36
#define POS_LH_C3R4 37
#define POS_LH_C2R4 38
#define POS_LH_C1R4 39
#define POS_RH_C1R4 40
#define POS_RH_C2R4 41
#define POS_RH_C3R4 42
#define POS_RH_C4R4 43
#define POS_RH_C5R4 44
#define POS_RH_C6R4 45
#define POS_LH_C6R5 46
#define POS_LH_C5R5 47
#define POS_LH_C4R5 48
#define POS_LH_C3R5 49
#define POS_LH_C2R5 50
#define POS_LH_C1R5 51
#define POS_LH_T1 52
#define POS_LH_T2 53
#define POS_LH_T3 54
#define POS_RH_T3 55
#define POS_RH_T2 56
#define POS_RH_T1 57
#define POS_RH_C1R5 58
#define POS_RH_C2R5 59
#define POS_RH_C3R5 60
#define POS_RH_C4R5 61
#define POS_RH_C5R5 62
#define POS_RH_C6R5 63
#define POS_LH_C6R6 64
#define POS_LH_C5R6 65
#define POS_LH_C4R6 66
#define POS_LH_C3R6 67
#define POS_LH_C2R6 68
#define POS_LH_T4 69
#define POS_LH_T5 70
#define POS_LH_T6 71
#define POS_RH_T6 72
#define POS_RH_T5 73
#define POS_RH_T4 74
#define POS_RH_C2R6 75
#define POS_RH_C3R6 76
#define POS_RH_C4R6 77
#define POS_RH_C5R6 78
#define POS_RH_C6R6 79


/* Custom Defined Behaviors */
/ {

};

/* Generated input processors */


/* Automatically generated macro definitions */
/ {
    macros {



        // Cursor Layer - Extent Line (seq) - TailorKey
        cur_EXTEND_LINE_v1_TKZ: cur_EXTEND_LINE_v1_TKZ {
            label = "&CUR_EXTEND_LINE_V1_TKZ";
            compatible = "zmk,behavior-macro";
            #binding-cells = <0>;
            tap-ms = <1>;
            wait-ms = <1>;
            bindings = <&kp LS(END)>;
        };

        // Cursor Layer - Extend Word (seq) - TailorKey
        cur_EXTEND_WORD_v1_TKZ: cur_EXTEND_WORD_v1_TKZ {
            label = "&CUR_EXTEND_WORD_V1_TKZ";
            compatible = "zmk,behavior-macro";
            #binding-cells = <0>;
            tap-ms = <1>;
            wait-ms = <1>;
            bindings = <&kp LC(LS(RIGHT))>;
        };

        // Cursor Layer - Select Line (seq) - TailorKey
        cur_SELECT_LINE_v1_TKZ: cur_SELECT_LINE_v1_TKZ {
            label = "&CUR_SELECT_LINE_V1_TKZ";
            compatible = "zmk,behavior-macro";
            #binding-cells = <0>;
            tap-ms = <1>;
            wait-ms = <1>;
            bindings = <&kp HOME>
                , <&kp LS(END)>;
        };

        // Cursor Layer - Select None (seq) - TailorKey
        cur_SELECT_NONE_v1_TKZ: cur_SELECT_NONE_v1_TKZ {
            label = "&CUR_SELECT_NONE_V1_TKZ";
            compatible = "zmk,behavior-macro";
            #binding-cells = <0>;
            tap-ms = <1>;
            wait-ms = <1>;
            bindings = <&kp DOWN>
                , <&kp UP>
                , <&kp RIGHT>
                , <&kp LEFT>;
        };

        // Cursor Layer - Select Word (seq) - TailorKey
        cur_SELECT_WORD_v1_TKZ: cur_SELECT_WORD_v1_TKZ {
            label = "&CUR_SELECT_WORD_V1_TKZ";
            compatible = "zmk,behavior-macro";
            #binding-cells = <0>;
            tap-ms = <1>;
            wait-ms = <1>;
            bindings = <&kp LC(LEFT)>
                , <&kp LC(LS(RIGHT))>;
        };

        // HRM_left_index_hold -> swich layer  - TailorKey
        HRM_left_index_hold_v1B_TKZ: HRM_left_index_hold_v1B_TKZ {
            label = "&HRM_LEFT_INDEX_HOLD_V1B_TKZ";
            compatible = "zmk,behavior-macro-one-param";
            #binding-cells = <1>;
            tap-ms = <0>;
            wait-ms = <0>;
            bindings = <&macro_press>
                , <&macro_param_1to1>
                , <&kp A>
                , <&mo LAYER_LeftIndex>
                , <&macro_pause_for_release>
                , <&macro_release>
                , <&macro_param_1to1>
                , <&kp A>
                , <&mo LAYER_LeftIndex>;
        };

        // HRM_left_index_tap - incl. QWERTY alpha character - TailorKey
        HRM_left_index_tap_v1B_TKZ: HRM_left_index_tap_v1B_TKZ {
            label = "&HRM_LEFT_INDEX_TAP_V1B_TKZ";
            compatible = "zmk,behavior-macro-one-param";
            #binding-cells = <1>;
            tap-ms = <0>;
            wait-ms = <0>;
            bindings = <&macro_release>
                , <&kp LSHFT>
                , <&kp RSHFT>
                , <&kp LALT>
                , <&kp RALT>
                , <&kp LCTRL>
                , <&kp RCTRL>
                , <&kp LGUI>
                , <&kp RGUI>
                , <&macro_tap>
                , <&kp N>
                , <&macro_tap>
                , <&macro_param_1to1>
                , <&kp A>;
        };

        // HRM_left_middy_hold -> swich layer - TailorKey
        HRM_left_middy_hold_v1B_TKZ: HRM_left_middy_hold_v1B_TKZ {
            label = "&HRM_LEFT_MIDDY_HOLD_V1B_TKZ";
            compatible = "zmk,behavior-macro-one-param";
            #binding-cells = <1>;
            tap-ms = <0>;
            wait-ms = <0>;
            bindings = <&macro_press>
                , <&macro_param_1to1>
                , <&kp A>
                , <&mo LAYER_LeftMiddy>
                , <&macro_pause_for_release>
                , <&macro_release>
                , <&macro_param_1to1>
                , <&kp A>
                , <&mo LAYER_LeftMiddy>;
        };

        // HRM_left_middy_tap - incl. QWERTY alpha character - TailorKey
        HRM_left_middy_tap_v1B_TKZ: HRM_left_middy_tap_v1B_TKZ {
            label = "&HRM_LEFT_MIDDY_TAP_V1B_TKZ";
            compatible = "zmk,behavior-macro-one-param";
            #binding-cells = <1>;
            tap-ms = <0>;
            wait-ms = <0>;
            bindings = <&macro_release>
                , <&kp LSHFT>
                , <&kp RSHFT>
                , <&kp LALT>
                , <&kp RALT>
                , <&kp LCTRL>
                , <&kp RCTRL>
                , <&kp LGUI>
                , <&kp RGUI>
                , <&macro_tap>
                , <&kp I>
                , <&macro_tap>
                , <&macro_param_1to1>
                , <&kp A>;
        };

        // HRM_left_pinky_hold -> swich layer - TailorKey
        HRM_left_pinky_hold_v1B_TKZ: HRM_left_pinky_hold_v1B_TKZ {
            label = "&HRM_LEFT_PINKY_HOLD_V1B_TKZ";
            compatible = "zmk,behavior-macro-one-param";
            #binding-cells = <1>;
            tap-ms = <0>;
            wait-ms = <0>;
            bindings = <&macro_press>
                , <&macro_param_1to1>
                , <&kp A>
                , <&mo LAYER_LeftPinky>
                , <&macro_pause_for_release>
                , <&macro_release>
                , <&macro_param_1to1>
                , <&kp A>
                , <&mo LAYER_LeftPinky>;
        };

        // HRM_left_pinky_tap - incl. QWERTY alpha character - TailorKey
        HRM_left_pinky_tap_v1B_TKZ: HRM_left_pinky_tap_v1B_TKZ {
            label = "&HRM_LEFT_PINKY_TAP_V1B_TKZ";
            compatible = "zmk,behavior-macro-one-param";
            #binding-cells = <1>;
            tap-ms = <0>;
            wait-ms = <0>;
            bindings = <&macro_release>
                , <&kp LSHFT>
                , <&kp RSHFT>
                , <&kp LALT>
                , <&kp RALT>
                , <&kp LCTRL>
                , <&kp RCTRL>
                , <&kp LGUI>
                , <&kp RGUI>
                , <&macro_tap>
                , <&kp A>
                , <&macro_tap>
                , <&macro_param_1to1>
                , <&kp A>;
        };

        // HRM_left_ring_hold -> swich layer - TailorKey
        HRM_left_ring_hold_v1B_TKZ: HRM_left_ring_hold_v1B_TKZ {
            label = "&HRM_LEFT_RING_HOLD_V1B_TKZ";
            compatible = "zmk,behavior-macro-one-param";
            #binding-cells = <1>;
            tap-ms = <0>;
            wait-ms = <0>;
            bindings = <&macro_press>
                , <&macro_param_1to1>
                , <&kp A>
                , <&mo LAYER_LeftRingy>
                , <&macro_pause_for_release>
                , <&macro_release>
                , <&macro_param_1to1>
                , <&kp A>
                , <&mo LAYER_LeftRingy>;
        };

        // HRM_left_ring_tap - incl. QWERTY alpha character - TailorKey
        HRM_left_ring_tap_v1B_TKZ: HRM_left_ring_tap_v1B_TKZ {
            label = "&HRM_LEFT_RING_TAP_V1B_TKZ";
            compatible = "zmk,behavior-macro-one-param";
            #binding-cells = <1>;
            tap-ms = <0>;
            wait-ms = <0>;
            bindings = <&macro_release>
                , <&kp LSHFT>
                , <&kp RSHFT>
                , <&kp LALT>
                , <&kp RALT>
                , <&kp LCTRL>
                , <&kp RCTRL>
                , <&kp LGUI>
                , <&kp RGUI>
                , <&macro_tap>
                , <&kp O>
                , <&macro_tap>
                , <&macro_param_1to1>
                , <&kp A>;
        };

        // HRM_right_index_hold -> swich layer - TailorKey
        HRM_right_index_hold_v1B_TKZ: HRM_right_index_hold_v1B_TKZ {
            label = "&HRM_RIGHT_INDEX_HOLD_V1B_TKZ";
            compatible = "zmk,behavior-macro-one-param";
            #binding-cells = <1>;
            tap-ms = <0>;
            wait-ms = <0>;
            bindings = <&macro_press>
                , <&macro_param_1to1>
                , <&kp A>
                , <&mo LAYER_RightIndex>
                , <&macro_pause_for_release>
                , <&macro_release>
                , <&macro_param_1to1>
                , <&kp A>
                , <&mo LAYER_RightIndex>;
        };

        // HRM_right_index_tap - incl. QWERTY alpha character - TailorKey
        HRM_right_index_tap_v1B_TKZ: HRM_right_index_tap_v1B_TKZ {
            label = "&HRM_RIGHT_INDEX_TAP_V1B_TKZ";
            compatible = "zmk,behavior-macro-one-param";
            #binding-cells = <1>;
            tap-ms = <0>;
            wait-ms = <0>;
            bindings = <&macro_release>
                , <&kp LSHFT>
                , <&kp RSHFT>
                , <&kp LALT>
                , <&kp RALT>
                , <&kp LCTRL>
                , <&kp RCTRL>
                , <&kp LGUI>
                , <&kp RGUI>
                , <&macro_tap>
                , <&kp H>
                , <&macro_tap>
                , <&macro_param_1to1>
                , <&kp A>;
        };

        // HRM_right_middy_hold -> swich layer - TailorKey
        HRM_right_middy_hold_v1B_TKZ: HRM_right_middy_hold_v1B_TKZ {
            label = "&HRM_RIGHT_MIDDY_HOLD_V1B_TKZ";
            compatible = "zmk,behavior-macro-one-param";
            #binding-cells = <1>;
            tap-ms = <0>;
            wait-ms = <0>;
            bindings = <&macro_press>
                , <&macro_param_1to1>
                , <&kp A>
                , <&mo LAYER_RightMiddy>
                , <&macro_pause_for_release>
                , <&macro_release>
                , <&macro_param_1to1>
                , <&kp A>
                , <&mo LAYER_RightMiddy>;
        };

        // HRM_right_middy_tap - incl. QWERTY alpha character - TailorKey
        HRM_right_middy_tap_v1B_TKZ: HRM_right_middy_tap_v1B_TKZ {
            label = "&HRM_RIGHT_MIDDY_TAP_V1B_TKZ";
            compatible = "zmk,behavior-macro-one-param";
            #binding-cells = <1>;
            tap-ms = <0>;
            wait-ms = <0>;
            bindings = <&macro_release>
                , <&kp LSHFT>
                , <&kp RSHFT>
                , <&kp LALT>
                , <&kp RALT>
                , <&kp LCTRL>
                , <&kp RCTRL>
                , <&kp LGUI>
                , <&kp RGUI>
                , <&macro_tap>
                , <&kp T>
                , <&macro_tap>
                , <&macro_param_1to1>
                , <&kp A>;
        };

        // HRM_right_pinky_hold -> swich layer - TailorKey
        HRM_right_pinky_hold_v1B_TKZ: HRM_right_pinky_hold_v1B_TKZ {
            label = "&HRM_RIGHT_PINKY_HOLD_V1B_TKZ";
            compatible = "zmk,behavior-macro-one-param";
            #binding-cells = <1>;
            tap-ms = <0>;
            wait-ms = <0>;
            bindings = <&macro_press>
                , <&macro_param_1to1>
                , <&kp A>
                , <&mo LAYER_RightPinky>
                , <&macro_pause_for_release>
                , <&macro_release>
                , <&macro_param_1to1>
                , <&kp A>
                , <&mo LAYER_RightPinky>;
        };

        // HRM_right_pinky_tap - incl. QWERTY alpha character - TailorKey
        HRM_right_pinky_tap_v1B_TKZ: HRM_right_pinky_tap_v1B_TKZ {
            label = "&HRM_RIGHT_PINKY_TAP_V1B_TKZ";
            compatible = "zmk,behavior-macro-one-param";
            #binding-cells = <1>;
            tap-ms = <0>;
            wait-ms = <0>;
            bindings = <&macro_release>
                , <&kp LSHFT>
                , <&kp RSHFT>
                , <&kp LALT>
                , <&kp RALT>
                , <&kp LCTRL>
                , <&kp RCTRL>
                , <&kp LGUI>
                , <&kp RGUI>
                , <&macro_tap>
                , <&kp R>
                , <&macro_tap>
                , <&macro_param_1to1>
                , <&kp A>;
        };

        // HRM_right_ring_hold -> swich layer - TailorKey
        HRM_right_ring_hold_v1B_TKZ: HRM_right_ring_hold_v1B_TKZ {
            label = "&HRM_RIGHT_RING_HOLD_V1B_TKZ";
            compatible = "zmk,behavior-macro-one-param";
            #binding-cells = <1>;
            tap-ms = <0>;
            wait-ms = <0>;
            bindings = <&macro_press>
                , <&macro_param_1to1>
                , <&kp A>
                , <&mo LAYER_RightRingy>
                , <&macro_pause_for_release>
                , <&macro_release>
                , <&macro_param_1to1>
                , <&kp A>
                , <&mo LAYER_RightRingy>;
        };

        // HRM_right_ring_tap - incl. QWERTY alpha character - TailorKey
        HRM_right_ring_tap_v1B_TKZ: HRM_right_ring_tap_v1B_TKZ {
            label = "&HRM_RIGHT_RING_TAP_V1B_TKZ";
            compatible = "zmk,behavior-macro-one-param";
            #binding-cells = <1>;
            tap-ms = <0>;
            wait-ms = <0>;
            bindings = <&macro_release>
                , <&kp LSHFT>
                , <&kp RSHFT>
                , <&kp LALT>
                , <&kp RALT>
                , <&kp LCTRL>
                , <&kp RCTRL>
                , <&kp LGUI>
                , <&kp RGUI>
                , <&macro_tap>
                , <&kp S>
                , <&macro_tap>
                , <&macro_param_1to1>
                , <&kp A>;
        };

        // mod_tab_switcher_chord -  TailorKey
        mod_tab_chord_v2_TKZ: mod_tab_chord_v2_TKZ {
            label = "&MOD_TAB_CHORD_V2_TKZ";
            compatible = "zmk,behavior-macro-two-param";
            #binding-cells = <2>;
            tap-ms = <0>;
            wait-ms = <0>;
            bindings = <&macro_press>
                , <&macro_param_2to1>
                , <&mo MACRO_PLACEHOLDER>
                , <&macro_press>
                , <&macro_param_1to1>
                , <&mod_tab_v1_TKZ MACRO_PLACEHOLDER>
                , <&macro_pause_for_release>
                , <&macro_release>
                , <&macro_param_1to1>
                , <&mod_tab_v1_TKZ MACRO_PLACEHOLDER>
                , <&macro_release>
                , <&macro_param_2to1>
                , <&mo MACRO_PLACEHOLDER>;
        };

        // mod_tab_switcher - TailorKey
        //
        //
        mod_tab_v1_TKZ: mod_tab_v1_TKZ {
            label = "&MOD_TAB_V1_TKZ";
            compatible = "zmk,behavior-macro-one-param";
            #binding-cells = <1>;
            tap-ms = <0>;
            wait-ms = <0>;
            bindings = <&macro_press>
                , <&macro_param_1to1>
                , <&kp MACRO_PLACEHOLDER>
                , <&macro_tap>
                , <&kp TAB>
                , <&macro_pause_for_release>
                , <&macro_release>
                , <&macro_param_1to1>
                , <&kp MACRO_PLACEHOLDER>;
        };

        // Symbol layer dot dot
        symb_dotdot_v1_TKZ: symb_dotdot_v1_TKZ {
            label = "&SYMB_DOTDOT_V1_TKZ";
            compatible = "zmk,behavior-macro";
            #binding-cells = <0>;
            tap-ms = <0>;
            wait-ms = <0>;
            bindings = <&macro_tap>
                , <&kp DOT>
                , <&kp DOT>;
        };
    };
};

/* Automatically generated behavior definitions */
/ {
    behaviors {



        // HRM_left_index_middy_bilateral -> &kp - &HRM_left_index_tap - TailorKey
        HRM_left_index_middy_v1B_TKZ: HRM_left_index_middy_v1B_TKZ {
            compatible = "zmk,behavior-hold-tap";
            #binding-cells = <2>;
            tapping-term-ms = <180>;
            bindings = <&kp>, <&HRM_left_index_tap_v1B_TKZ>;
            flavor = "tap-preferred";
            quick-tap-ms = <300>;
            require-prior-idle-ms = <100>;
            hold-trigger-key-positions = <POS_RH_T1 POS_RH_T2 POS_RH_T3 POS_RH_T6 POS_RH_T5 POS_RH_T4 POS_RH_C2R1 POS_RH_C3R1 POS_RH_C4R1 POS_RH_C5R1 POS_RH_C1R2 POS_RH_C2R2 POS_RH_C3R2 POS_RH_C4R2 POS_RH_C5R2 POS_RH_C1R3 POS_RH_C2R3 POS_RH_C3R3 POS_RH_C4R3 POS_RH_C5R3 POS_RH_C1R4 POS_RH_C2R4 POS_RH_C3R4 POS_RH_C4R4 POS_RH_C5R4 POS_RH_C1R5 POS_RH_C2R5 POS_RH_C3R5 POS_RH_C4R5 POS_RH_C5R5 POS_RH_C2R6 POS_RH_C3R6 POS_RH_C4R6 POS_RH_C5R6 POS_RH_C6R1 POS_RH_C6R2 POS_RH_C6R3 POS_RH_C6R4 POS_RH_C6R5 POS_RH_C6R6 POS_LH_T1 POS_LH_T2 POS_LH_T3 POS_LH_T5 POS_LH_T6 POS_LH_T4>;
            hold-trigger-on-release;
        };

        // HRM_left_index_pinky_bilateral -> &kp - &HRM_left_index_tap - TailorKey
        HRM_left_index_pinky_v1B_TKZ: HRM_left_index_pinky_v1B_TKZ {
            compatible = "zmk,behavior-hold-tap";
            #binding-cells = <2>;
            tapping-term-ms = <180>;
            bindings = <&kp>, <&HRM_left_index_tap_v1B_TKZ>;
            flavor = "tap-preferred";
            quick-tap-ms = <300>;
            require-prior-idle-ms = <100>;
            hold-trigger-key-positions = <POS_RH_T1 POS_RH_T2 POS_RH_T3 POS_RH_T6 POS_RH_T5 POS_RH_T4 POS_RH_C2R1 POS_RH_C3R1 POS_RH_C4R1 POS_RH_C5R1 POS_RH_C1R2 POS_RH_C2R2 POS_RH_C3R2 POS_RH_C4R2 POS_RH_C5R2 POS_RH_C1R3 POS_RH_C2R3 POS_RH_C3R3 POS_RH_C4R3 POS_RH_C5R3 POS_RH_C1R4 POS_RH_C2R4 POS_RH_C3R4 POS_RH_C4R4 POS_RH_C5R4 POS_RH_C1R5 POS_RH_C2R5 POS_RH_C3R5 POS_RH_C4R5 POS_RH_C5R5 POS_RH_C2R6 POS_RH_C3R6 POS_RH_C4R6 POS_RH_C5R6 POS_RH_C6R1 POS_RH_C6R2 POS_RH_C6R3 POS_RH_C6R4 POS_RH_C6R5 POS_RH_C6R6 POS_LH_T1 POS_LH_T2 POS_LH_T3 POS_LH_T5 POS_LH_T6 POS_LH_T4>;
            hold-trigger-on-release;
        };

        // HRM_left_index_ring_bilateral -> &kp - &HRM_left_index_tap - TailorKey
        HRM_left_index_ringv1_TKZ: HRM_left_index_ringv1_TKZ {
            compatible = "zmk,behavior-hold-tap";
            #binding-cells = <2>;
            tapping-term-ms = <180>;
            bindings = <&kp>, <&HRM_left_index_tap_v1B_TKZ>;
            flavor = "tap-preferred";
            quick-tap-ms = <300>;
            require-prior-idle-ms = <100>;
            hold-trigger-key-positions = <POS_RH_T1 POS_RH_T2 POS_RH_T3 POS_RH_T6 POS_RH_T5 POS_RH_T4 POS_RH_C2R1 POS_RH_C3R1 POS_RH_C4R1 POS_RH_C5R1 POS_RH_C1R2 POS_RH_C2R2 POS_RH_C3R2 POS_RH_C4R2 POS_RH_C5R2 POS_RH_C1R3 POS_RH_C2R3 POS_RH_C3R3 POS_RH_C4R3 POS_RH_C5R3 POS_RH_C1R4 POS_RH_C2R4 POS_RH_C3R4 POS_RH_C4R4 POS_RH_C5R4 POS_RH_C1R5 POS_RH_C2R5 POS_RH_C3R5 POS_RH_C4R5 POS_RH_C5R5 POS_RH_C2R6 POS_RH_C3R6 POS_RH_C4R6 POS_RH_C5R6 POS_RH_C6R1 POS_RH_C6R2 POS_RH_C6R3 POS_RH_C6R4 POS_RH_C6R5 POS_RH_C6R6 POS_LH_T1 POS_LH_T2 POS_LH_T3 POS_LH_T5 POS_LH_T6 POS_LH_T4>;
            hold-trigger-on-release;
        };

        // HRM_left_index_bilateral -> &HRM_left_index_hold -> &kp - TailorKey
        HRM_left_index_v1B_TKZ: HRM_left_index_v1B_TKZ {
            compatible = "zmk,behavior-hold-tap";
            #binding-cells = <2>;
            tapping-term-ms = <180>;
            bindings = <&HRM_left_index_hold_v1B_TKZ>, <&kp>;
            flavor = "tap-preferred";
            quick-tap-ms = <300>;
            require-prior-idle-ms = <100>;
            hold-trigger-key-positions = <POS_RH_T1 POS_RH_T2 POS_RH_T3 POS_RH_T6 POS_RH_T5 POS_RH_T4 POS_RH_C2R1 POS_RH_C3R1 POS_RH_C4R1 POS_RH_C5R1 POS_RH_C1R2 POS_RH_C2R2 POS_RH_C3R2 POS_RH_C4R2 POS_RH_C5R2 POS_RH_C1R3 POS_RH_C2R3 POS_RH_C3R3 POS_RH_C4R3 POS_RH_C5R3 POS_RH_C1R4 POS_RH_C2R4 POS_RH_C3R4 POS_RH_C4R4 POS_RH_C5R4 POS_RH_C1R5 POS_RH_C2R5 POS_RH_C3R5 POS_RH_C4R5 POS_RH_C5R5 POS_RH_C2R6 POS_RH_C3R6 POS_RH_C4R6 POS_RH_C5R6 POS_RH_C6R1 POS_RH_C6R2 POS_RH_C6R3 POS_RH_C6R4 POS_RH_C6R5 POS_RH_C6R6 POS_LH_T1 POS_LH_T2 POS_LH_T3 POS_LH_T5 POS_LH_T6 POS_LH_T4>;
            hold-trigger-on-release;
        };

        // HRM_left_middy_index_bilateral  -> &kp ->&HRM_left_middy_tap - TailorKey
        HRM_left_middy_index_v1B_TKZ: HRM_left_middy_index_v1B_TKZ {
            compatible = "zmk,behavior-hold-tap";
            #binding-cells = <2>;
            tapping-term-ms = <210>;
            bindings = <&kp>, <&HRM_left_middy_tap_v1B_TKZ>;
            flavor = "tap-preferred";
            quick-tap-ms = <300>;
            require-prior-idle-ms = <150>;
            hold-trigger-key-positions = <POS_RH_T1 POS_RH_T2 POS_RH_T3 POS_RH_T6 POS_RH_T5 POS_RH_T4 POS_RH_C2R1 POS_RH_C3R1 POS_RH_C4R1 POS_RH_C5R1 POS_RH_C1R2 POS_RH_C2R2 POS_RH_C3R2 POS_RH_C4R2 POS_RH_C5R2 POS_RH_C1R3 POS_RH_C2R3 POS_RH_C3R3 POS_RH_C4R3 POS_RH_C5R3 POS_RH_C1R4 POS_RH_C2R4 POS_RH_C3R4 POS_RH_C4R4 POS_RH_C5R4 POS_RH_C1R5 POS_RH_C2R5 POS_RH_C3R5 POS_RH_C4R5 POS_RH_C5R5 POS_RH_C2R6 POS_RH_C3R6 POS_RH_C4R6 POS_RH_C5R6 POS_RH_C6R1 POS_RH_C6R2 POS_RH_C6R3 POS_RH_C6R4 POS_RH_C6R5 POS_RH_C6R6 POS_LH_T1 POS_LH_T2 POS_LH_T3 POS_LH_T5 POS_LH_T6 POS_LH_T4>;
            hold-trigger-on-release;
        };

        // HRM_left_middy_pinky_bilateral -> &kp - &HRM_left_pinky_tap - TailorKey
        HRM_left_middy_pinky_v1B_TKZ: HRM_left_middy_pinky_v1B_TKZ {
            compatible = "zmk,behavior-hold-tap";
            #binding-cells = <2>;
            tapping-term-ms = <210>;
            bindings = <&kp>, <&HRM_left_middy_tap_v1B_TKZ>;
            flavor = "tap-preferred";
            quick-tap-ms = <300>;
            require-prior-idle-ms = <150>;
            hold-trigger-key-positions = <POS_RH_T1 POS_RH_T2 POS_RH_T3 POS_RH_T6 POS_RH_T5 POS_RH_T4 POS_RH_C2R1 POS_RH_C3R1 POS_RH_C4R1 POS_RH_C5R1 POS_RH_C1R2 POS_RH_C2R2 POS_RH_C3R2 POS_RH_C4R2 POS_RH_C5R2 POS_RH_C1R3 POS_RH_C2R3 POS_RH_C3R3 POS_RH_C4R3 POS_RH_C5R3 POS_RH_C1R4 POS_RH_C2R4 POS_RH_C3R4 POS_RH_C4R4 POS_RH_C5R4 POS_RH_C1R5 POS_RH_C2R5 POS_RH_C3R5 POS_RH_C4R5 POS_RH_C5R5 POS_RH_C2R6 POS_RH_C3R6 POS_RH_C4R6 POS_RH_C5R6 POS_RH_C6R1 POS_RH_C6R2 POS_RH_C6R3 POS_RH_C6R4 POS_RH_C6R5 POS_RH_C6R6 POS_LH_T1 POS_LH_T2 POS_LH_T3 POS_LH_T5 POS_LH_T6 POS_LH_T4>;
            hold-trigger-on-release;
        };

        // HRM_left_middy_ring_bilateral -> &kp - &HRM_left_middy_tap - TailorKey
        HRM_left_middy_ring_v1B_TKZ: HRM_left_middy_ring_v1B_TKZ {
            compatible = "zmk,behavior-hold-tap";
            #binding-cells = <2>;
            tapping-term-ms = <210>;
            bindings = <&kp>, <&HRM_left_middy_tap_v1B_TKZ>;
            flavor = "tap-preferred";
            quick-tap-ms = <300>;
            require-prior-idle-ms = <150>;
            hold-trigger-key-positions = <POS_RH_T1 POS_RH_T2 POS_RH_T3 POS_RH_T6 POS_RH_T5 POS_RH_T4 POS_RH_C2R1 POS_RH_C3R1 POS_RH_C4R1 POS_RH_C5R1 POS_RH_C1R2 POS_RH_C2R2 POS_RH_C3R2 POS_RH_C4R2 POS_RH_C5R2 POS_RH_C1R3 POS_RH_C2R3 POS_RH_C3R3 POS_RH_C4R3 POS_RH_C5R3 POS_RH_C1R4 POS_RH_C2R4 POS_RH_C3R4 POS_RH_C4R4 POS_RH_C5R4 POS_RH_C1R5 POS_RH_C2R5 POS_RH_C3R5 POS_RH_C4R5 POS_RH_C5R5 POS_RH_C2R6 POS_RH_C3R6 POS_RH_C4R6 POS_RH_C5R6 POS_RH_C6R1 POS_RH_C6R2 POS_RH_C6R3 POS_RH_C6R4 POS_RH_C6R5 POS_RH_C6R6 POS_LH_T1 POS_LH_T2 POS_LH_T3 POS_LH_T5 POS_LH_T6 POS_LH_T4>;
            hold-trigger-on-release;
        };

        // HRM_left_middy_bilateral -> &HRM_left_index_hold -> &kp - TailorKey
        HRM_left_middy_v1B_TKZ: HRM_left_middy_v1B_TKZ {
            compatible = "zmk,behavior-hold-tap";
            #binding-cells = <2>;
            tapping-term-ms = <210>;
            bindings = <&HRM_left_middy_hold_v1B_TKZ>, <&kp>;
            flavor = "tap-preferred";
            quick-tap-ms = <300>;
            require-prior-idle-ms = <150>;
            hold-trigger-key-positions = <POS_RH_T1 POS_RH_T2 POS_RH_T3 POS_RH_T6 POS_RH_T5 POS_RH_T4 POS_RH_C2R1 POS_RH_C3R1 POS_RH_C4R1 POS_RH_C5R1 POS_RH_C1R2 POS_RH_C2R2 POS_RH_C3R2 POS_RH_C4R2 POS_RH_C5R2 POS_RH_C1R3 POS_RH_C2R3 POS_RH_C3R3 POS_RH_C4R3 POS_RH_C5R3 POS_RH_C1R4 POS_RH_C2R4 POS_RH_C3R4 POS_RH_C4R4 POS_RH_C5R4 POS_RH_C1R5 POS_RH_C2R5 POS_RH_C3R5 POS_RH_C4R5 POS_RH_C5R5 POS_RH_C2R6 POS_RH_C3R6 POS_RH_C4R6 POS_RH_C5R6 POS_RH_C6R1 POS_RH_C6R2 POS_RH_C6R3 POS_RH_C6R4 POS_RH_C6R5 POS_RH_C6R6 POS_LH_T1 POS_LH_T2 POS_LH_T3 POS_LH_T5 POS_LH_T6 POS_LH_T4>;
            hold-trigger-on-release;
        };

        // HRM_left_pinky_index_bilateral  -> &kp ->&HRM_left_pinky_tap - TailorKey
        HRM_left_pinky_index_v1B_TKZ: HRM_left_pinky_index_v1B_TKZ {
            compatible = "zmk,behavior-hold-tap";
            #binding-cells = <2>;
            tapping-term-ms = <270>;
            bindings = <&kp>, <&HRM_left_pinky_tap_v1B_TKZ>;
            flavor = "tap-preferred";
            quick-tap-ms = <300>;
            require-prior-idle-ms = <150>;
            hold-trigger-key-positions = <POS_RH_T1 POS_RH_T2 POS_RH_T3 POS_RH_T6 POS_RH_T5 POS_RH_T4 POS_RH_C2R1 POS_RH_C3R1 POS_RH_C4R1 POS_RH_C5R1 POS_RH_C1R2 POS_RH_C2R2 POS_RH_C3R2 POS_RH_C4R2 POS_RH_C5R2 POS_RH_C1R3 POS_RH_C2R3 POS_RH_C3R3 POS_RH_C4R3 POS_RH_C5R3 POS_RH_C1R4 POS_RH_C2R4 POS_RH_C3R4 POS_RH_C4R4 POS_RH_C5R4 POS_RH_C1R5 POS_RH_C2R5 POS_RH_C3R5 POS_RH_C4R5 POS_RH_C5R5 POS_RH_C2R6 POS_RH_C3R6 POS_RH_C4R6 POS_RH_C5R6 POS_RH_C6R1 POS_RH_C6R2 POS_RH_C6R3 POS_RH_C6R4 POS_RH_C6R5 POS_RH_C6R6 POS_LH_T1 POS_LH_T2 POS_LH_T3 POS_LH_T5 POS_LH_T6 POS_LH_T4>;
            hold-trigger-on-release;
        };

        // HRM_left_pinky_middy_bilateral -> &kp - &HRM_left_pinky_tap - TailorKey
        HRM_left_pinky_middy_v1B_TKZ: HRM_left_pinky_middy_v1B_TKZ {
            compatible = "zmk,behavior-hold-tap";
            #binding-cells = <2>;
            tapping-term-ms = <270>;
            bindings = <&kp>, <&HRM_left_pinky_tap_v1B_TKZ>;
            flavor = "tap-preferred";
            quick-tap-ms = <300>;
            require-prior-idle-ms = <150>;
            hold-trigger-key-positions = <POS_RH_T1 POS_RH_T2 POS_RH_T3 POS_RH_T6 POS_RH_T5 POS_RH_T4 POS_RH_C2R1 POS_RH_C3R1 POS_RH_C4R1 POS_RH_C5R1 POS_RH_C1R2 POS_RH_C2R2 POS_RH_C3R2 POS_RH_C4R2 POS_RH_C5R2 POS_RH_C1R3 POS_RH_C2R3 POS_RH_C3R3 POS_RH_C4R3 POS_RH_C5R3 POS_RH_C1R4 POS_RH_C2R4 POS_RH_C3R4 POS_RH_C4R4 POS_RH_C5R4 POS_RH_C1R5 POS_RH_C2R5 POS_RH_C3R5 POS_RH_C4R5 POS_RH_C5R5 POS_RH_C2R6 POS_RH_C3R6 POS_RH_C4R6 POS_RH_C5R6 POS_RH_C6R1 POS_RH_C6R2 POS_RH_C6R3 POS_RH_C6R4 POS_RH_C6R5 POS_RH_C6R6 POS_LH_T1 POS_LH_T2 POS_LH_T3 POS_LH_T5 POS_LH_T6 POS_LH_T4>;
            hold-trigger-on-release;
        };

        // HRM_left_pinky_ring_bilateral -> &kp - &HRM_left_pinky_tap - TailorKey
        HRM_left_pinky_ring_v1B_TKZ: HRM_left_pinky_ring_v1B_TKZ {
            compatible = "zmk,behavior-hold-tap";
            #binding-cells = <2>;
            tapping-term-ms = <270>;
            bindings = <&kp>, <&HRM_left_pinky_tap_v1B_TKZ>;
            flavor = "tap-preferred";
            quick-tap-ms = <300>;
            require-prior-idle-ms = <150>;
            hold-trigger-key-positions = <POS_RH_T1 POS_RH_T2 POS_RH_T3 POS_RH_T6 POS_RH_T5 POS_RH_T4 POS_RH_C2R1 POS_RH_C3R1 POS_RH_C4R1 POS_RH_C5R1 POS_RH_C1R2 POS_RH_C2R2 POS_RH_C3R2 POS_RH_C4R2 POS_RH_C5R2 POS_RH_C1R3 POS_RH_C2R3 POS_RH_C3R3 POS_RH_C4R3 POS_RH_C5R3 POS_RH_C1R4 POS_RH_C2R4 POS_RH_C3R4 POS_RH_C4R4 POS_RH_C5R4 POS_RH_C1R5 POS_RH_C2R5 POS_RH_C3R5 POS_RH_C4R5 POS_RH_C5R5 POS_RH_C2R6 POS_RH_C3R6 POS_RH_C4R6 POS_RH_C5R6 POS_RH_C6R1 POS_RH_C6R2 POS_RH_C6R3 POS_RH_C6R4 POS_RH_C6R5 POS_RH_C6R6 POS_LH_T1 POS_LH_T2 POS_LH_T3 POS_LH_T5 POS_LH_T6 POS_LH_T4>;
            hold-trigger-on-release;
        };

        // HRM_left_pinky_bilateral  - &HRM_left_pinky_hold -> &kp - TailorKey
        HRM_left_pinky_v1B_TKZ: HRM_left_pinky_v1B_TKZ {
            compatible = "zmk,behavior-hold-tap";
            #binding-cells = <2>;
            tapping-term-ms = <270>;
            bindings = <&HRM_left_pinky_hold_v1B_TKZ>, <&kp>;
            flavor = "tap-preferred";
            quick-tap-ms = <300>;
            require-prior-idle-ms = <150>;
            hold-trigger-key-positions = <POS_RH_T1 POS_RH_T2 POS_RH_T3 POS_RH_T6 POS_RH_T5 POS_RH_T4 POS_RH_C2R1 POS_RH_C3R1 POS_RH_C4R1 POS_RH_C5R1 POS_RH_C1R2 POS_RH_C2R2 POS_RH_C3R2 POS_RH_C4R2 POS_RH_C5R2 POS_RH_C1R3 POS_RH_C2R3 POS_RH_C3R3 POS_RH_C4R3 POS_RH_C5R3 POS_RH_C1R4 POS_RH_C2R4 POS_RH_C3R4 POS_RH_C4R4 POS_RH_C5R4 POS_RH_C1R5 POS_RH_C2R5 POS_RH_C3R5 POS_RH_C4R5 POS_RH_C5R5 POS_RH_C2R6 POS_RH_C3R6 POS_RH_C4R6 POS_RH_C5R6 POS_RH_C6R1 POS_RH_C6R2 POS_RH_C6R3 POS_RH_C6R4 POS_RH_C6R5 POS_RH_C6R6 POS_LH_T1 POS_LH_T2 POS_LH_T3 POS_LH_T5 POS_LH_T6 POS_LH_T4>;
            hold-trigger-on-release;
        };

        // HRM_left_ring_index_bilateral  -> &kp ->&HRM_left_ring_tap - TailorKey
        HRM_left_ring_index_v1B_TKZ: HRM_left_ring_index_v1B_TKZ {
            compatible = "zmk,behavior-hold-tap";
            #binding-cells = <2>;
            tapping-term-ms = <240>;
            bindings = <&kp>, <&HRM_left_ring_tap_v1B_TKZ>;
            flavor = "tap-preferred";
            quick-tap-ms = <300>;
            require-prior-idle-ms = <100>;
            hold-trigger-key-positions = <POS_RH_T1 POS_RH_T2 POS_RH_T3 POS_RH_T6 POS_RH_T5 POS_RH_T4 POS_RH_C2R1 POS_RH_C3R1 POS_RH_C4R1 POS_RH_C5R1 POS_RH_C1R2 POS_RH_C2R2 POS_RH_C3R2 POS_RH_C4R2 POS_RH_C5R2 POS_RH_C1R3 POS_RH_C2R3 POS_RH_C3R3 POS_RH_C4R3 POS_RH_C5R3 POS_RH_C1R4 POS_RH_C2R4 POS_RH_C3R4 POS_RH_C4R4 POS_RH_C5R4 POS_RH_C1R5 POS_RH_C2R5 POS_RH_C3R5 POS_RH_C4R5 POS_RH_C5R5 POS_RH_C2R6 POS_RH_C3R6 POS_RH_C4R6 POS_RH_C5R6 POS_RH_C6R1 POS_RH_C6R2 POS_RH_C6R3 POS_RH_C6R4 POS_RH_C6R5 POS_RH_C6R6 POS_LH_T1 POS_LH_T2 POS_LH_T3 POS_LH_T5 POS_LH_T6 POS_LH_T4>;
            hold-trigger-on-release;
        };

        // HRM_left_ring_middy_bilateral -> &kp - &HRM_left_ring_tap - TailorKey
        HRM_left_ring_middy_v1B_TKZ: HRM_left_ring_middy_v1B_TKZ {
            compatible = "zmk,behavior-hold-tap";
            #binding-cells = <2>;
            tapping-term-ms = <240>;
            bindings = <&kp>, <&HRM_left_ring_tap_v1B_TKZ>;
            flavor = "tap-preferred";
            quick-tap-ms = <300>;
            require-prior-idle-ms = <100>;
            hold-trigger-key-positions = <POS_RH_T1 POS_RH_T2 POS_RH_T3 POS_RH_T6 POS_RH_T5 POS_RH_T4 POS_RH_C2R1 POS_RH_C3R1 POS_RH_C4R1 POS_RH_C5R1 POS_RH_C1R2 POS_RH_C2R2 POS_RH_C3R2 POS_RH_C4R2 POS_RH_C5R2 POS_RH_C1R3 POS_RH_C2R3 POS_RH_C3R3 POS_RH_C4R3 POS_RH_C5R3 POS_RH_C1R4 POS_RH_C2R4 POS_RH_C3R4 POS_RH_C4R4 POS_RH_C5R4 POS_RH_C1R5 POS_RH_C2R5 POS_RH_C3R5 POS_RH_C4R5 POS_RH_C5R5 POS_RH_C2R6 POS_RH_C3R6 POS_RH_C4R6 POS_RH_C5R6 POS_RH_C6R1 POS_RH_C6R2 POS_RH_C6R3 POS_RH_C6R4 POS_RH_C6R5 POS_RH_C6R6 POS_LH_T1 POS_LH_T2 POS_LH_T3 POS_LH_T5 POS_LH_T6 POS_LH_T4>;
            hold-trigger-on-release;
        };

        // HRM_left_ring_pinky_bilateral -> &kp - &HRM_left_ring_tap - TailorKey
        HRM_left_ring_pinky_v1B_TKZ: HRM_left_ring_pinky_v1B_TKZ {
            compatible = "zmk,behavior-hold-tap";
            #binding-cells = <2>;
            tapping-term-ms = <240>;
            bindings = <&kp>, <&HRM_left_ring_tap_v1B_TKZ>;
            flavor = "tap-preferred";
            quick-tap-ms = <300>;
            require-prior-idle-ms = <100>;
            hold-trigger-key-positions = <POS_RH_T1 POS_RH_T2 POS_RH_T3 POS_RH_T6 POS_RH_T5 POS_RH_T4 POS_RH_C2R1 POS_RH_C3R1 POS_RH_C4R1 POS_RH_C5R1 POS_RH_C1R2 POS_RH_C2R2 POS_RH_C3R2 POS_RH_C4R2 POS_RH_C5R2 POS_RH_C1R3 POS_RH_C2R3 POS_RH_C3R3 POS_RH_C4R3 POS_RH_C5R3 POS_RH_C1R4 POS_RH_C2R4 POS_RH_C3R4 POS_RH_C4R4 POS_RH_C5R4 POS_RH_C1R5 POS_RH_C2R5 POS_RH_C3R5 POS_RH_C4R5 POS_RH_C5R5 POS_RH_C2R6 POS_RH_C3R6 POS_RH_C4R6 POS_RH_C5R6 POS_RH_C6R1 POS_RH_C6R2 POS_RH_C6R3 POS_RH_C6R4 POS_RH_C6R5 POS_RH_C6R6 POS_LH_T1 POS_LH_T2 POS_LH_T3 POS_LH_T5 POS_LH_T6 POS_LH_T4>;
            hold-trigger-on-release;
        };

        // HRM_left_ring_bilateral  - &HRM_left_ring_hold -> &kp - TailorKey
        HRM_left_ring_v1B_TKZ: HRM_left_ring_v1B_TKZ {
            compatible = "zmk,behavior-hold-tap";
            #binding-cells = <2>;
            tapping-term-ms = <240>;
            bindings = <&HRM_left_ring_hold_v1B_TKZ>, <&kp>;
            flavor = "tap-preferred";
            quick-tap-ms = <300>;
            require-prior-idle-ms = <100>;
            hold-trigger-key-positions = <POS_RH_T1 POS_RH_T2 POS_RH_T3 POS_RH_T6 POS_RH_T5 POS_RH_T4 POS_RH_C2R1 POS_RH_C3R1 POS_RH_C4R1 POS_RH_C5R1 POS_RH_C1R2 POS_RH_C2R2 POS_RH_C3R2 POS_RH_C4R2 POS_RH_C5R2 POS_RH_C1R3 POS_RH_C2R3 POS_RH_C3R3 POS_RH_C4R3 POS_RH_C5R3 POS_RH_C1R4 POS_RH_C2R4 POS_RH_C3R4 POS_RH_C4R4 POS_RH_C5R4 POS_RH_C1R5 POS_RH_C2R5 POS_RH_C3R5 POS_RH_C4R5 POS_RH_C5R5 POS_RH_C2R6 POS_RH_C3R6 POS_RH_C4R6 POS_RH_C5R6 POS_RH_C6R1 POS_RH_C6R2 POS_RH_C6R3 POS_RH_C6R4 POS_RH_C6R5 POS_RH_C6R6 POS_LH_T1 POS_LH_T2 POS_LH_T3 POS_LH_T5 POS_LH_T6 POS_LH_T4>;
            hold-trigger-on-release;
        };

        // HRM_right_index_middy_bilateral -> &kp - &HRM_right_index_tap - TailorKey
        HRM_right_index_middy_v1B_TKZ: HRM_right_index_middy_v1B_TKZ {
            compatible = "zmk,behavior-hold-tap";
            #binding-cells = <2>;
            tapping-term-ms = <180>;
            bindings = <&kp>, <&HRM_right_index_tap_v1B_TKZ>;
            flavor = "tap-preferred";
            quick-tap-ms = <300>;
            require-prior-idle-ms = <100>;
            hold-trigger-key-positions = <POS_LH_C6R1 POS_LH_C6R2 POS_LH_C6R3 POS_LH_C6R4 POS_LH_C6R5 POS_LH_C6R6 POS_LH_C5R6 POS_LH_C5R5 POS_LH_C5R4 POS_LH_C5R3 POS_LH_C5R1 POS_LH_C4R1 POS_LH_C4R2 POS_LH_C5R2 POS_LH_C4R3 POS_LH_C4R4 POS_LH_C4R5 POS_LH_C4R6 POS_LH_C3R6 POS_LH_C3R5 POS_LH_C3R4 POS_LH_C3R3 POS_LH_C3R2 POS_LH_C3R1 POS_LH_C2R1 POS_LH_C2R2 POS_LH_C1R2 POS_LH_C1R3 POS_LH_C2R3 POS_LH_C2R4 POS_LH_C1R4 POS_LH_C1R5 POS_LH_C2R5 POS_LH_C2R6 POS_LH_T1 POS_LH_T2 POS_LH_T3 POS_LH_T6 POS_LH_T5 POS_LH_T4 POS_RH_T3 POS_RH_T2 POS_RH_T1 POS_RH_T4 POS_RH_T5 POS_RH_T6>;
            hold-trigger-on-release;
        };

        // HRM_right_index_pinky_bilateral -> &kp - &HRM_right_index_tap - TailorKey
        HRM_right_index_pinky_v1B_TKZ: HRM_right_index_pinky_v1B_TKZ {
            compatible = "zmk,behavior-hold-tap";
            #binding-cells = <2>;
            tapping-term-ms = <180>;
            bindings = <&kp>, <&HRM_right_index_tap_v1B_TKZ>;
            flavor = "tap-preferred";
            quick-tap-ms = <300>;
            require-prior-idle-ms = <100>;
            hold-trigger-key-positions = <POS_LH_C6R1 POS_LH_C6R2 POS_LH_C6R3 POS_LH_C6R4 POS_LH_C6R5 POS_LH_C6R6 POS_LH_C5R6 POS_LH_C5R5 POS_LH_C5R4 POS_LH_C5R3 POS_LH_C5R1 POS_LH_C4R1 POS_LH_C4R2 POS_LH_C5R2 POS_LH_C4R3 POS_LH_C4R4 POS_LH_C4R5 POS_LH_C4R6 POS_LH_C3R6 POS_LH_C3R5 POS_LH_C3R4 POS_LH_C3R3 POS_LH_C3R2 POS_LH_C3R1 POS_LH_C2R1 POS_LH_C2R2 POS_LH_C1R2 POS_LH_C1R3 POS_LH_C2R3 POS_LH_C2R4 POS_LH_C1R4 POS_LH_C1R5 POS_LH_C2R5 POS_LH_C2R6 POS_LH_T1 POS_LH_T2 POS_LH_T3 POS_LH_T6 POS_LH_T5 POS_LH_T4 POS_RH_T3 POS_RH_T2 POS_RH_T1 POS_RH_T4 POS_RH_T5 POS_RH_T6>;
            hold-trigger-on-release;
        };

        // HRM_right_index_ring_bilateral -> &kp - &HRM_right_index_tap - TailorKey
        HRM_right_index_ring_v1B_TKZ: HRM_right_index_ring_v1B_TKZ {
            compatible = "zmk,behavior-hold-tap";
            #binding-cells = <2>;
            tapping-term-ms = <180>;
            bindings = <&kp>, <&HRM_right_index_tap_v1B_TKZ>;
            flavor = "tap-preferred";
            quick-tap-ms = <300>;
            require-prior-idle-ms = <100>;
            hold-trigger-key-positions = <POS_LH_C6R1 POS_LH_C6R2 POS_LH_C6R3 POS_LH_C6R4 POS_LH_C6R5 POS_LH_C6R6 POS_LH_C5R6 POS_LH_C5R5 POS_LH_C5R4 POS_LH_C5R3 POS_LH_C5R1 POS_LH_C4R1 POS_LH_C4R2 POS_LH_C5R2 POS_LH_C4R3 POS_LH_C4R4 POS_LH_C4R5 POS_LH_C4R6 POS_LH_C3R6 POS_LH_C3R5 POS_LH_C3R4 POS_LH_C3R3 POS_LH_C3R2 POS_LH_C3R1 POS_LH_C2R1 POS_LH_C2R2 POS_LH_C1R2 POS_LH_C1R3 POS_LH_C2R3 POS_LH_C2R4 POS_LH_C1R4 POS_LH_C1R5 POS_LH_C2R5 POS_LH_C2R6 POS_LH_T1 POS_LH_T2 POS_LH_T3 POS_LH_T6 POS_LH_T5 POS_LH_T4 POS_RH_T3 POS_RH_T2 POS_RH_T1 POS_RH_T4 POS_RH_T5 POS_RH_T6>;
            hold-trigger-on-release;
        };

        // HRM_right_index_bilateral -> &HRM_right_index_hold -> &kp - TailorKey
        HRM_right_index_v1B_TKZ: HRM_right_index_v1B_TKZ {
            compatible = "zmk,behavior-hold-tap";
            #binding-cells = <2>;
            tapping-term-ms = <180>;
            bindings = <&HRM_right_index_hold_v1B_TKZ>, <&kp>;
            flavor = "tap-preferred";
            quick-tap-ms = <300>;
            require-prior-idle-ms = <100>;
            hold-trigger-key-positions = <POS_LH_C6R1 POS_LH_C6R2 POS_LH_C6R3 POS_LH_C6R4 POS_LH_C6R5 POS_LH_C6R6 POS_LH_C5R6 POS_LH_C5R5 POS_LH_C5R4 POS_LH_C5R3 POS_LH_C5R1 POS_LH_C4R1 POS_LH_C4R2 POS_LH_C5R2 POS_LH_C4R3 POS_LH_C4R4 POS_LH_C4R5 POS_LH_C4R6 POS_LH_C3R6 POS_LH_C3R5 POS_LH_C3R4 POS_LH_C3R3 POS_LH_C3R2 POS_LH_C3R1 POS_LH_C2R1 POS_LH_C2R2 POS_LH_C1R2 POS_LH_C1R3 POS_LH_C2R3 POS_LH_C2R4 POS_LH_C1R4 POS_LH_C1R5 POS_LH_C2R5 POS_LH_C2R6 POS_LH_T1 POS_LH_T2 POS_LH_T3 POS_LH_T6 POS_LH_T5 POS_LH_T4 POS_RH_T3 POS_RH_T2 POS_RH_T1 POS_RH_T4 POS_RH_T5 POS_RH_T6>;
            hold-trigger-on-release;
        };

        // HRM_right_middy_index_bilateral  -> &kp ->&HRM_right_middy_tap - TailorKey
        HRM_right_middy_index_v1B_TKZ: HRM_right_middy_index_v1B_TKZ {
            compatible = "zmk,behavior-hold-tap";
            #binding-cells = <2>;
            tapping-term-ms = <210>;
            bindings = <&kp>, <&HRM_right_middy_tap_v1B_TKZ>;
            flavor = "tap-preferred";
            quick-tap-ms = <300>;
            require-prior-idle-ms = <150>;
            hold-trigger-key-positions = <POS_LH_C6R1 POS_LH_C6R2 POS_LH_C6R3 POS_LH_C6R4 POS_LH_C6R5 POS_LH_C6R6 POS_LH_C5R6 POS_LH_C5R5 POS_LH_C5R4 POS_LH_C5R3 POS_LH_C5R1 POS_LH_C4R1 POS_LH_C4R2 POS_LH_C5R2 POS_LH_C4R3 POS_LH_C4R4 POS_LH_C4R5 POS_LH_C4R6 POS_LH_C3R6 POS_LH_C3R5 POS_LH_C3R4 POS_LH_C3R3 POS_LH_C3R2 POS_LH_C3R1 POS_LH_C2R1 POS_LH_C2R2 POS_LH_C1R2 POS_LH_C1R3 POS_LH_C2R3 POS_LH_C2R4 POS_LH_C1R4 POS_LH_C1R5 POS_LH_C2R5 POS_LH_C2R6 POS_LH_T1 POS_LH_T2 POS_LH_T3 POS_LH_T6 POS_LH_T5 POS_LH_T4 POS_RH_T3 POS_RH_T2 POS_RH_T1 POS_RH_T4 POS_RH_T5 POS_RH_T6>;
            hold-trigger-on-release;
        };

        // HRM_right_middy_pinky_bilateral -> &kp - &HRM_right_pinky_tap - TailorKey
        HRM_right_middy_pinky_v1B_TKZ: HRM_right_middy_pinky_v1B_TKZ {
            compatible = "zmk,behavior-hold-tap";
            #binding-cells = <2>;
            tapping-term-ms = <210>;
            bindings = <&kp>, <&HRM_right_middy_tap_v1B_TKZ>;
            flavor = "tap-preferred";
            quick-tap-ms = <300>;
            require-prior-idle-ms = <150>;
            hold-trigger-key-positions = <POS_LH_C6R1 POS_LH_C6R2 POS_LH_C6R3 POS_LH_C6R5 POS_LH_C6R6 POS_LH_C5R6 POS_LH_C5R5 POS_LH_T1 POS_LH_C1R5 POS_LH_C1R4 POS_LH_C1R3 POS_LH_C1R2 POS_LH_C2R1 POS_LH_C3R1 POS_LH_C4R1 POS_LH_C5R1 POS_LH_C5R2 POS_LH_C5R3 POS_LH_C5R4 POS_LH_C6R4 POS_LH_C4R5 POS_LH_C4R6 POS_LH_T4 POS_LH_T5 POS_LH_T6 POS_LH_T3 POS_LH_T2 POS_RH_T3 POS_RH_T2 POS_RH_T1 POS_RH_T4 POS_RH_T5 POS_RH_T6 POS_LH_C2R6 POS_LH_C3R6 POS_LH_C3R5 POS_LH_C2R5 POS_LH_C2R4 POS_LH_C2R3 POS_LH_C2R2 POS_LH_C3R2 POS_LH_C3R3 POS_LH_C3R4 POS_LH_C4R3 POS_LH_C4R2 POS_LH_C4R4>;
            hold-trigger-on-release;
        };

        // HRM_right_middy_ring_bilateral -> &kp - &HRM_right_middy_tap - TailorKey
        HRM_right_middy_ring_v1B_TKZ: HRM_right_middy_ring_v1B_TKZ {
            compatible = "zmk,behavior-hold-tap";
            #binding-cells = <2>;
            tapping-term-ms = <210>;
            bindings = <&kp>, <&HRM_right_middy_tap_v1B_TKZ>;
            flavor = "tap-preferred";
            quick-tap-ms = <300>;
            require-prior-idle-ms = <150>;
            hold-trigger-key-positions = <POS_LH_C6R1 POS_LH_C6R2 POS_LH_C6R3 POS_LH_C6R4 POS_LH_C6R5 POS_LH_C6R6 POS_LH_C5R6 POS_LH_C5R5 POS_LH_C5R4 POS_LH_C5R3 POS_LH_C5R1 POS_LH_C4R1 POS_LH_C4R2 POS_LH_C5R2 POS_LH_C4R3 POS_LH_C4R4 POS_LH_C4R5 POS_LH_C4R6 POS_LH_C3R6 POS_LH_C3R5 POS_LH_C3R4 POS_LH_C3R3 POS_LH_C3R2 POS_LH_C3R1 POS_LH_C2R1 POS_LH_C2R2 POS_LH_C1R2 POS_LH_C1R3 POS_LH_C2R3 POS_LH_C2R4 POS_LH_C1R4 POS_LH_C1R5 POS_LH_C2R5 POS_LH_C2R6 POS_LH_T1 POS_LH_T2 POS_LH_T3 POS_LH_T6 POS_LH_T5 POS_LH_T4 POS_RH_T3 POS_RH_T2 POS_RH_T1 POS_RH_T4 POS_RH_T5 POS_RH_T6>;
            hold-trigger-on-release;
        };

        // HRM_right_middy_bilateral -> &HRM_right_index_hold -> &kp - TailorKey
        HRM_right_middy_v1B_TKZ: HRM_right_middy_v1B_TKZ {
            compatible = "zmk,behavior-hold-tap";
            #binding-cells = <2>;
            tapping-term-ms = <210>;
            bindings = <&HRM_right_middy_hold_v1B_TKZ>, <&kp>;
            flavor = "tap-preferred";
            quick-tap-ms = <300>;
            require-prior-idle-ms = <150>;
            hold-trigger-key-positions = <POS_LH_C6R1 POS_LH_C6R2 POS_LH_C6R3 POS_LH_C6R4 POS_LH_C6R5 POS_LH_C6R6 POS_LH_C5R6 POS_LH_C5R5 POS_LH_C5R4 POS_LH_C5R3 POS_LH_C5R1 POS_LH_C4R1 POS_LH_C4R2 POS_LH_C5R2 POS_LH_C4R3 POS_LH_C4R4 POS_LH_C4R5 POS_LH_C4R6 POS_LH_C3R6 POS_LH_C3R5 POS_LH_C3R4 POS_LH_C3R3 POS_LH_C3R2 POS_LH_C3R1 POS_LH_C2R1 POS_LH_C2R2 POS_LH_C1R2 POS_LH_C1R3 POS_LH_C2R3 POS_LH_C2R4 POS_LH_C1R4 POS_LH_C1R5 POS_LH_C2R5 POS_LH_C2R6 POS_LH_T1 POS_LH_T2 POS_LH_T3 POS_LH_T6 POS_LH_T5 POS_LH_T4 POS_RH_T3 POS_RH_T2 POS_RH_T1 POS_RH_T4 POS_RH_T5 POS_RH_T6>;
            hold-trigger-on-release;
        };

        // HRM_right_pinky_index_bilateral  -> &kp ->&HRM_right_pinky_tap - TailorKey
        HRM_right_pinky_index_v1B_TKZ: HRM_right_pinky_index_v1B_TKZ {
            compatible = "zmk,behavior-hold-tap";
            #binding-cells = <2>;
            tapping-term-ms = <270>;
            bindings = <&kp>, <&HRM_right_pinky_tap_v1B_TKZ>;
            flavor = "tap-preferred";
            quick-tap-ms = <300>;
            require-prior-idle-ms = <150>;
            hold-trigger-key-positions = <POS_LH_C6R1 POS_LH_C6R2 POS_LH_C6R3 POS_LH_C6R4 POS_LH_C6R5 POS_LH_C6R6 POS_LH_C5R6 POS_LH_C5R5 POS_LH_C5R4 POS_LH_C5R3 POS_LH_C5R1 POS_LH_C4R1 POS_LH_C4R2 POS_LH_C5R2 POS_LH_C4R3 POS_LH_C4R4 POS_LH_C4R5 POS_LH_C4R6 POS_LH_C3R6 POS_LH_C3R5 POS_LH_C3R4 POS_LH_C3R3 POS_LH_C3R2 POS_LH_C3R1 POS_LH_C2R1 POS_LH_C2R2 POS_LH_C1R2 POS_LH_C1R3 POS_LH_C2R3 POS_LH_C2R4 POS_LH_C1R4 POS_LH_C1R5 POS_LH_C2R5 POS_LH_C2R6 POS_LH_T1 POS_LH_T2 POS_LH_T3 POS_LH_T6 POS_LH_T5 POS_LH_T4 POS_RH_T3 POS_RH_T2 POS_RH_T1 POS_RH_T4 POS_RH_T5 POS_RH_T6>;
            hold-trigger-on-release;
        };

        // HRM_right_pinky_middy_bilateral -> &kp - &HRM_right_pinky_tap - TailorKey
        HRM_right_pinky_middy_v1B_TKZ: HRM_right_pinky_middy_v1B_TKZ {
            compatible = "zmk,behavior-hold-tap";
            #binding-cells = <2>;
            tapping-term-ms = <270>;
            bindings = <&kp>, <&HRM_right_pinky_tap_v1B_TKZ>;
            flavor = "tap-preferred";
            quick-tap-ms = <300>;
            require-prior-idle-ms = <150>;
            hold-trigger-key-positions = <POS_LH_C6R1 POS_LH_C6R2 POS_LH_C6R3 POS_LH_C6R4 POS_LH_C6R5 POS_LH_C6R6 POS_LH_C5R6 POS_LH_C5R5 POS_LH_C5R4 POS_LH_C5R3 POS_LH_C5R1 POS_LH_C4R1 POS_LH_C4R2 POS_LH_C5R2 POS_LH_C4R3 POS_LH_C4R4 POS_LH_C4R5 POS_LH_C4R6 POS_LH_C3R6 POS_LH_C3R5 POS_LH_C3R4 POS_LH_C3R3 POS_LH_C3R2 POS_LH_C3R1 POS_LH_C2R1 POS_LH_C2R2 POS_LH_C1R2 POS_LH_C1R3 POS_LH_C2R3 POS_LH_C2R4 POS_LH_C1R4 POS_LH_C1R5 POS_LH_C2R5 POS_LH_C2R6 POS_LH_T1 POS_LH_T2 POS_LH_T3 POS_LH_T6 POS_LH_T5 POS_LH_T4 POS_RH_T3 POS_RH_T2 POS_RH_T1 POS_RH_T4 POS_RH_T5 POS_RH_T6>;
            hold-trigger-on-release;
        };

        // HRM_right_pinky_ring_bilateral -> &kp - &HRM_right_pinky_tap - TailorKey
        HRM_right_pinky_ring_v1B_TKZ: HRM_right_pinky_ring_v1B_TKZ {
            compatible = "zmk,behavior-hold-tap";
            #binding-cells = <2>;
            tapping-term-ms = <270>;
            bindings = <&kp>, <&HRM_right_pinky_tap_v1B_TKZ>;
            flavor = "tap-preferred";
            quick-tap-ms = <300>;
            require-prior-idle-ms = <150>;
            hold-trigger-key-positions = <POS_LH_C6R1 POS_LH_C6R2 POS_LH_C6R3 POS_LH_C6R4 POS_LH_C6R5 POS_LH_C6R6 POS_LH_C5R6 POS_LH_C5R5 POS_LH_C5R4 POS_LH_C5R3 POS_LH_C5R1 POS_LH_C4R1 POS_LH_C4R2 POS_LH_C5R2 POS_LH_C4R3 POS_LH_C4R4 POS_LH_C4R5 POS_LH_C4R6 POS_LH_C3R6 POS_LH_C3R5 POS_LH_C3R4 POS_LH_C3R3 POS_LH_C3R2 POS_LH_C3R1 POS_LH_C2R1 POS_LH_C2R2 POS_LH_C1R2 POS_LH_C1R3 POS_LH_C2R3 POS_LH_C2R4 POS_LH_C1R4 POS_LH_C1R5 POS_LH_C2R5 POS_LH_C2R6 POS_LH_T1 POS_LH_T2 POS_LH_T3 POS_LH_T6 POS_LH_T5 POS_LH_T4 POS_RH_T3 POS_RH_T2 POS_RH_T1 POS_RH_T4 POS_RH_T5 POS_RH_T6>;
            hold-trigger-on-release;
        };

        // HRM_right_pinky_bilateral  - &HRM_right_pinky_hold -> &kp - TailorKey
        HRM_right_pinky_v1B_TKZ: HRM_right_pinky_v1B_TKZ {
            compatible = "zmk,behavior-hold-tap";
            #binding-cells = <2>;
            tapping-term-ms = <270>;
            bindings = <&HRM_right_pinky_hold_v1B_TKZ>, <&kp>;
            flavor = "tap-preferred";
            quick-tap-ms = <300>;
            require-prior-idle-ms = <150>;
            hold-trigger-key-positions = <POS_LH_C6R1 POS_LH_C6R2 POS_LH_C6R3 POS_LH_C6R4 POS_LH_C6R5 POS_LH_C6R6 POS_LH_C5R6 POS_LH_C5R5 POS_LH_C5R4 POS_LH_C5R3 POS_LH_C5R1 POS_LH_C4R1 POS_LH_C4R2 POS_LH_C5R2 POS_LH_C4R3 POS_LH_C4R4 POS_LH_C4R5 POS_LH_C4R6 POS_LH_C3R6 POS_LH_C3R5 POS_LH_C3R4 POS_LH_C3R3 POS_LH_C3R2 POS_LH_C3R1 POS_LH_C2R1 POS_LH_C2R2 POS_LH_C1R2 POS_LH_C1R3 POS_LH_C2R3 POS_LH_C2R4 POS_LH_C1R4 POS_LH_C1R5 POS_LH_C2R5 POS_LH_C2R6 POS_LH_T1 POS_LH_T2 POS_LH_T3 POS_LH_T6 POS_LH_T5 POS_LH_T4 POS_RH_T3 POS_RH_T2 POS_RH_T1 POS_RH_T4 POS_RH_T5 POS_RH_T6>;
            hold-trigger-on-release;
        };

        // HRM_right_ring_index_bilateral  -> &kp ->&HRM_right_ring_tap - TailorKey
        HRM_right_ring_index_v1B_TKZ: HRM_right_ring_index_v1B_TKZ {
            compatible = "zmk,behavior-hold-tap";
            #binding-cells = <2>;
            tapping-term-ms = <240>;
            bindings = <&kp>, <&HRM_right_ring_tap_v1B_TKZ>;
            flavor = "tap-preferred";
            quick-tap-ms = <300>;
            require-prior-idle-ms = <100>;
            hold-trigger-key-positions = <POS_LH_C6R1 POS_LH_C6R2 POS_LH_C6R3 POS_LH_C6R4 POS_LH_C6R5 POS_LH_C6R6 POS_LH_C5R6 POS_LH_C5R5 POS_LH_C5R4 POS_LH_C5R3 POS_LH_C5R1 POS_LH_C4R1 POS_LH_C4R2 POS_LH_C5R2 POS_LH_C4R3 POS_LH_C4R4 POS_LH_C4R5 POS_LH_C4R6 POS_LH_C3R6 POS_LH_C3R5 POS_LH_C3R4 POS_LH_C3R3 POS_LH_C3R2 POS_LH_C3R1 POS_LH_C2R1 POS_LH_C2R2 POS_LH_C1R2 POS_LH_C1R3 POS_LH_C2R3 POS_LH_C2R4 POS_LH_C1R4 POS_LH_C1R5 POS_LH_C2R5 POS_LH_C2R6 POS_LH_T1 POS_LH_T2 POS_LH_T3 POS_LH_T6 POS_LH_T5 POS_LH_T4 POS_RH_T3 POS_RH_T2 POS_RH_T1 POS_RH_T4 POS_RH_T5 POS_RH_T6>;
            hold-trigger-on-release;
        };

        // HRM_right_ring_middy_bilateral -> &kp - &HRM_right_ring_tap - TailorKey
        HRM_right_ring_middy_v1B_TKZ: HRM_right_ring_middy_v1B_TKZ {
            compatible = "zmk,behavior-hold-tap";
            #binding-cells = <2>;
            tapping-term-ms = <240>;
            bindings = <&kp>, <&HRM_right_ring_tap_v1B_TKZ>;
            flavor = "tap-preferred";
            quick-tap-ms = <300>;
            require-prior-idle-ms = <100>;
            hold-trigger-key-positions = <POS_LH_C6R1 POS_LH_C6R2 POS_LH_C6R3 POS_LH_C6R4 POS_LH_C6R5 POS_LH_C6R6 POS_LH_C5R6 POS_LH_C5R5 POS_LH_C5R4 POS_LH_C5R3 POS_LH_C5R1 POS_LH_C4R1 POS_LH_C4R2 POS_LH_C5R2 POS_LH_C4R3 POS_LH_C4R4 POS_LH_C4R5 POS_LH_C4R6 POS_LH_C3R6 POS_LH_C3R5 POS_LH_C3R4 POS_LH_C3R3 POS_LH_C3R2 POS_LH_C3R1 POS_LH_C2R1 POS_LH_C2R2 POS_LH_C1R2 POS_LH_C1R3 POS_LH_C2R3 POS_LH_C2R4 POS_LH_C1R4 POS_LH_C1R5 POS_LH_C2R5 POS_LH_C2R6 POS_LH_T1 POS_LH_T2 POS_LH_T3 POS_LH_T6 POS_LH_T5 POS_LH_T4 POS_RH_T3 POS_RH_T2 POS_RH_T1 POS_RH_T4 POS_RH_T5 POS_RH_T6>;
            hold-trigger-on-release;
        };

        // HRM_right_ring_pinky_bilateral -> &kp - &HRM_right_ring_tap - TailorKey
        HRM_right_ring_pinky_v1B_TKZ: HRM_right_ring_pinky_v1B_TKZ {
            compatible = "zmk,behavior-hold-tap";
            #binding-cells = <2>;
            tapping-term-ms = <240>;
            bindings = <&kp>, <&HRM_right_ring_tap_v1B_TKZ>;
            flavor = "tap-preferred";
            quick-tap-ms = <300>;
            require-prior-idle-ms = <100>;
            hold-trigger-key-positions = <POS_LH_C6R1 POS_LH_C6R2 POS_LH_C6R3 POS_LH_C6R4 POS_LH_C6R5 POS_LH_C6R6 POS_LH_C5R6 POS_LH_C5R5 POS_LH_C5R4 POS_LH_C5R3 POS_LH_C5R1 POS_LH_C4R1 POS_LH_C4R2 POS_LH_C5R2 POS_LH_C4R3 POS_LH_C4R4 POS_LH_C4R5 POS_LH_C4R6 POS_LH_C3R6 POS_LH_C3R5 POS_LH_C3R4 POS_LH_C3R3 POS_LH_C3R2 POS_LH_C3R1 POS_LH_C2R1 POS_LH_C2R2 POS_LH_C1R2 POS_LH_C1R3 POS_LH_C2R3 POS_LH_C2R4 POS_LH_C1R4 POS_LH_C1R5 POS_LH_C2R5 POS_LH_C2R6 POS_LH_T1 POS_LH_T2 POS_LH_T3 POS_LH_T6 POS_LH_T5 POS_LH_T4 POS_RH_T3 POS_RH_T2 POS_RH_T1 POS_RH_T4 POS_RH_T5 POS_RH_T6>;
            hold-trigger-on-release;
        };

        // HRM_right_ring_bilateral  - &HRM_right_ring_hold -> &kp - TailorKey
        HRM_right_ring_v1B_TKZ: HRM_right_ring_v1B_TKZ {
            compatible = "zmk,behavior-hold-tap";
            #binding-cells = <2>;
            tapping-term-ms = <240>;
            bindings = <&HRM_right_ring_hold_v1B_TKZ>, <&kp>;
            flavor = "tap-preferred";
            quick-tap-ms = <300>;
            require-prior-idle-ms = <100>;
            hold-trigger-key-positions = <POS_LH_C6R1 POS_LH_C6R2 POS_LH_C6R3 POS_LH_C6R4 POS_LH_C6R5 POS_LH_C6R6 POS_LH_C5R6 POS_LH_C5R5 POS_LH_C5R4 POS_LH_C5R3 POS_LH_C5R1 POS_LH_C4R1 POS_LH_C4R2 POS_LH_C5R2 POS_LH_C4R3 POS_LH_C4R4 POS_LH_C4R5 POS_LH_C4R6 POS_LH_C3R6 POS_LH_C3R5 POS_LH_C3R4 POS_LH_C3R3 POS_LH_C3R2 POS_LH_C3R1 POS_LH_C2R1 POS_LH_C2R2 POS_LH_C1R2 POS_LH_C1R3 POS_LH_C2R3 POS_LH_C2R4 POS_LH_C1R4 POS_LH_C1R5 POS_LH_C2R5 POS_LH_C2R6 POS_LH_T1 POS_LH_T2 POS_LH_T3 POS_LH_T6 POS_LH_T5 POS_LH_T4 POS_RH_T3 POS_RH_T2 POS_RH_T1 POS_RH_T4 POS_RH_T5 POS_RH_T6>;
            hold-trigger-on-release;
        };

        // space_layer_access - TailorKey
        space_v3_TKZ: space_v3_TKZ {
            compatible = "zmk,behavior-hold-tap";
            #binding-cells = <2>;
            tapping-term-ms = <200>;
            bindings = <&mo>, <&kp>;
            flavor = "balanced";
            quick-tap-ms = <150>;
            require-prior-idle-ms = <0>;
        };

        // thumb_layer_access - TailorKey
        thumb_v2_TKZ: thumb_v2_TKZ {
            compatible = "zmk,behavior-hold-tap";
            #binding-cells = <2>;
            tapping-term-ms = <200>;
            bindings = <&mo>, <&kp>;
            flavor = "balanced";
            quick-tap-ms = <300>;
            require-prior-idle-ms = <0>;
        };
    };
};

/* Automatically generated combos definitions */
/ {
    combos {
        compatible = "zmk,combos";

        // F11 on RH_C5 and RH_R1+R2 - TailorKey
        combo_F11_v1_TKZ {
            timeout-ms = <50>;
            key-positions = <POS_RH_C5R1 POS_RH_C5R2>;
            bindings = <&kp F11>;
            layers = <LAYER_Base>;
        };

        // F12 on RH_C6 and RH_R1+R2 - TailorKey
        combo_F12_v1_TKZ {
            timeout-ms = <50>;
            key-positions = <POS_RH_C6R1 POS_RH_C6R2>;
            bindings = <&kp F12>;
            layers = <LAYER_Base>;
        };


        // GE - combo_ctrl_tab_switcher_left
//
        combo_left_ctrl_tab_switcher_v1_TKZ {
            key-positions = <POS_LH_T2 POS_LH_T5>;
            bindings = <&mod_tab_chord_v2_TKZ LCTRL LAYER_Cursor>;
            layers = <LAYER_Base>;
        };

        // GE - meh_ACS_right
//
        combo_right_meh_ACS_v1_TKZ {
            key-positions = <POS_RH_T2 POS_RH_T5>;
            bindings = <&kp LA(LC(LSHFT))>;
            layers = <LAYER_Base>;
        };

        // GE - combo_caps_lock_right
        combo_right_caps_lock_v1_TKZ {
            key-positions = <POS_RH_T2 POS_RH_T6>;
            bindings = <&kp CAPS>;
            layers = <LAYER_Base>;
        };



        // GE - combo_caps_word_right
        combo_right_caps_word_v1_TKZ {
            key-positions = <POS_RH_T5 POS_RH_T4>;
            bindings = <&caps_word>;
            layers = <LAYER_Base>;
        };


        combo_gaming_layer_toggle_v1_TKZ {
            key-positions = <POS_LH_C1R5 POS_LH_C2R6>;
            bindings = <&tog LAYER_Gaming>;
            layers = <LAYER_Base LAYER_Gaming>;
        };
    };
};

/* Automatically generated keymap */
/ {
    keymap {
        compatible = "zmk,keymap";


        layer_Base {
            bindings = <
                &kp F1  &kp F2  &kp F3  &kp F4  &kp F5  &kp F6  &kp F7  &kp F8  &kp F9  &kp F10
                &none  &kp N1  &kp N2  &kp N3  &kp N4  &kp N5  &kp N6  &kp N7  &kp N8  &kp N9  &kp N0  &none
                &kp RA(N8)  &kp Q  &kp J  &kp U  &kp L  &kp RA(U)  &kp B  &kp P  &kp F  &kp W  &kp X  &kp BSLH
                &kp SEMI  &HRM_left_pinky_v1B_TKZ LGUI A  &HRM_left_ring_v1B_TKZ LALT O  &HRM_left_middy_v1B_TKZ LCTRL I  &HRM_left_index_v1B_TKZ LSHFT N  &kp RA(O)  &kp K  &HRM_right_index_v1B_TKZ RSHFT H  &HRM_right_middy_v1B_TKZ RCTRL T  &HRM_right_ring_v1B_TKZ LALT S  &HRM_right_pinky_v1B_TKZ RGUI R  &kp Y
                &kp GRAVE  &kp SQT  &kp DOT  &kp COMMA  &kp M  &kp RA(A)  &thumb_v2_TKZ LAYER_Aerospace ESC  &thumb_v2_TKZ LAYER_Function INS  &none  &caps_word  &kp DEL  &kp RET  &kp Z  &kp D  &kp G  &kp C  &kp V  &none
                &magic LAYER_Magic 0  &kp HOME  &kp FSLH  &kp MINUS  &kp EQUAL  &kp E  &thumb_v2_TKZ LAYER_Numbers TAB  &mo LAYER_Cursor  &none  &thumb_v2_TKZ LAYER_Mouse BSPC  &space_v3_TKZ LAYER_Symbol SPACE  &none  &kp LBKT  &kp RBKT  &none  &magic LAYER_Magic 0
            >;
        };

        layer_Typing {
            bindings = <
               &trans  &trans  &trans  &trans  &trans                                                                  &trans  &trans  &trans  &trans  &trans
               &trans  &trans  &trans  &trans  &trans  &trans                                                  &trans  &trans  &trans  &trans  &trans  &trans
               &trans  &trans  &trans  &trans  &trans  &trans                                                  &trans  &trans  &trans  &trans  &trans  &trans
               &trans   &kp A   &kp O   &kp I   &kp N  &trans                                                  &trans   &kp H   &kp T   &kp S   &kp R  &trans
               &trans  &trans  &trans  &trans  &trans  &trans  &trans  &trans  &trans  &trans  &trans  &trans  &trans  &trans  &trans  &trans  &trans  &trans
 &magic LAYER_Magic 0  &trans  &trans  &trans  &trans          &trans  &trans  &trans  &trans  &trans  &trans          &trans  &trans  &trans  &trans  &trans
            >;
        };


        layer_LeftPinky {
            bindings = <
    &HRM_left_pinky_tap_v1B_TKZ F1   &HRM_left_pinky_tap_v1B_TKZ F2       &HRM_left_pinky_tap_v1B_TKZ F3         &HRM_left_pinky_tap_v1B_TKZ F4         &HRM_left_pinky_tap_v1B_TKZ F5                                                                                                                      &trans  &trans  &trans  &trans  &trans
                            &trans   &HRM_left_pinky_tap_v1B_TKZ N1       &HRM_left_pinky_tap_v1B_TKZ N2         &HRM_left_pinky_tap_v1B_TKZ N3         &HRM_left_pinky_tap_v1B_TKZ N4     &HRM_left_pinky_tap_v1B_TKZ N5                                                                           &trans  &trans  &trans  &trans  &trans  &trans
                            &trans    &HRM_left_pinky_tap_v1B_TKZ Q        &HRM_left_pinky_tap_v1B_TKZ J          &HRM_left_pinky_tap_v1B_TKZ U          &HRM_left_pinky_tap_v1B_TKZ L  &HRM_left_pinky_tap_v1B_TKZ RA(U)                                                                           &trans  &trans  &trans  &trans  &trans  &trans
  &HRM_left_pinky_tap_v1B_TKZ SEMI                            &none  &HRM_left_pinky_ring_v1B_TKZ LALT O  &HRM_left_pinky_middy_v1B_TKZ LCTRL I  &HRM_left_pinky_index_v1B_TKZ LSHFT N  &HRM_left_pinky_tap_v1B_TKZ RA(O)                                                                           &trans   &kp H   &kp T   &kp S   &kp R  &trans
 &HRM_left_pinky_tap_v1B_TKZ GRAVE  &HRM_left_pinky_tap_v1B_TKZ SQT      &HRM_left_pinky_tap_v1B_TKZ DOT      &HRM_left_pinky_tap_v1B_TKZ COMMA          &HRM_left_pinky_tap_v1B_TKZ M  &HRM_left_pinky_tap_v1B_TKZ RA(A)  &HRM_left_pinky_tap_v1B_TKZ ESC  &trans  &trans  &trans  &trans  &trans  &trans  &trans  &trans  &trans  &trans  &trans
                            &trans                           &trans     &HRM_left_pinky_tap_v1B_TKZ FSLH      &HRM_left_pinky_tap_v1B_TKZ MINUS      &HRM_left_pinky_tap_v1B_TKZ EQUAL                                       &HRM_left_pinky_tap_v1B_TKZ E  &trans  &trans  &trans  &trans  &trans          &trans  &trans  &trans  &trans  &trans
            >;
        };

        layer_LeftRingy {
            bindings = <
    &HRM_left_ring_tap_v1B_TKZ F1        &HRM_left_ring_tap_v1B_TKZ F2    &HRM_left_ring_tap_v1B_TKZ F3         &HRM_left_ring_tap_v1B_TKZ F4         &HRM_left_ring_tap_v1B_TKZ F5                                                                                                                    &trans  &trans  &trans  &trans  &trans
                           &trans        &HRM_left_ring_tap_v1B_TKZ N1    &HRM_left_ring_tap_v1B_TKZ N2         &HRM_left_ring_tap_v1B_TKZ N3         &HRM_left_ring_tap_v1B_TKZ N4     &HRM_left_ring_tap_v1B_TKZ N5                                                                          &trans  &trans  &trans  &trans  &trans  &trans
                           &trans         &HRM_left_ring_tap_v1B_TKZ Q     &HRM_left_ring_tap_v1B_TKZ J          &HRM_left_ring_tap_v1B_TKZ U          &HRM_left_ring_tap_v1B_TKZ L  &HRM_left_ring_tap_v1B_TKZ RA(U)                                                                          &trans  &trans  &trans  &trans  &trans  &trans
  &HRM_left_ring_tap_v1B_TKZ SEMI  &HRM_left_ring_pinky_v1B_TKZ LGUI A                            &none  &HRM_left_ring_middy_v1B_TKZ LCTRL I  &HRM_left_ring_index_v1B_TKZ LSHFT N  &HRM_left_ring_tap_v1B_TKZ RA(O)                                                                          &trans   &kp H   &kp T   &kp S   &kp R  &trans
 &HRM_left_ring_tap_v1B_TKZ GRAVE       &HRM_left_ring_tap_v1B_TKZ SQT   &HRM_left_ring_tap_v1B_TKZ DOT      &HRM_left_ring_tap_v1B_TKZ COMMA          &HRM_left_ring_tap_v1B_TKZ M  &HRM_left_ring_tap_v1B_TKZ RA(A)  &HRM_left_ring_tap_v1B_TKZ ESC  &trans  &trans  &trans  &trans  &trans  &trans  &trans  &trans  &trans  &trans  &trans
                           &trans                               &trans  &HRM_left_ring_tap_v1B_TKZ FSLH      &HRM_left_ring_tap_v1B_TKZ MINUS      &HRM_left_ring_tap_v1B_TKZ EQUAL                                      &HRM_left_ring_tap_v1B_TKZ E  &trans  &trans  &trans  &trans  &trans          &trans  &trans  &trans  &trans  &trans
            >;
        };

        layer_LeftMiddy {
            bindings = <
                &HRM_left_middy_tap_v1B_TKZ F1  &HRM_left_middy_tap_v1B_TKZ F2  &HRM_left_middy_tap_v1B_TKZ F3  &HRM_left_middy_tap_v1B_TKZ F4  &HRM_left_middy_tap_v1B_TKZ F5  &trans  &trans  &trans  &trans  &trans
                &trans  &HRM_left_middy_tap_v1B_TKZ N1  &HRM_left_middy_tap_v1B_TKZ N2  &HRM_left_middy_tap_v1B_TKZ N3  &HRM_left_middy_tap_v1B_TKZ N4  &HRM_left_middy_tap_v1B_TKZ N5  &trans  &trans  &trans  &trans  &trans  &trans
                &trans  &HRM_left_middy_tap_v1B_TKZ Q  &HRM_left_middy_tap_v1B_TKZ J  &HRM_left_middy_tap_v1B_TKZ U  &HRM_left_middy_tap_v1B_TKZ L  &HRM_left_middy_tap_v1B_TKZ RA(U)  &trans  &trans  &trans  &trans  &trans  &trans
                &HRM_left_middy_tap_v1B_TKZ SEMI  &HRM_left_middy_pinky_v1B_TKZ LGUI A  &HRM_left_middy_ring_v1B_TKZ LALT O  &none  &HRM_left_middy_index_v1B_TKZ LSHFT N  &HRM_left_middy_tap_v1B_TKZ RA(O)  &trans  &kp H  &kp T  &kp S  &kp R  &trans
                &HRM_left_middy_tap_v1B_TKZ GRAVE  &HRM_left_middy_tap_v1B_TKZ SQT  &HRM_left_middy_tap_v1B_TKZ DOT  &HRM_left_middy_tap_v1B_TKZ COMMA  &HRM_left_middy_tap_v1B_TKZ M  &HRM_left_middy_tap_v1B_TKZ RA(A)  &HRM_left_middy_tap_v1B_TKZ ESC  &trans  &trans  &trans  &trans  &trans  &trans  &trans  &trans  &trans  &trans  &trans
                &trans  &trans  &HRM_left_middy_tap_v1B_TKZ FSLH  &HRM_left_middy_tap_v1B_TKZ MINUS  &HRM_left_middy_tap_v1B_TKZ EQUAL  &HRM_left_middy_tap_v1B_TKZ E  &trans  &trans  &trans  &trans  &trans  &trans  &trans  &trans  &trans  &trans
            >;
        };

        layer_LeftIndex {
            bindings = <
                &HRM_left_index_tap_v1B_TKZ F1  &HRM_left_index_tap_v1B_TKZ F2  &HRM_left_index_tap_v1B_TKZ F3  &HRM_left_index_tap_v1B_TKZ F4  &HRM_left_index_tap_v1B_TKZ F5  &trans  &trans  &trans  &trans  &trans
                &trans  &HRM_left_index_tap_v1B_TKZ N1  &HRM_left_index_tap_v1B_TKZ N2  &HRM_left_index_tap_v1B_TKZ N3  &HRM_left_index_tap_v1B_TKZ N4  &HRM_left_index_tap_v1B_TKZ N5  &trans  &trans  &trans  &trans  &trans  &trans
                &trans  &HRM_left_index_tap_v1B_TKZ Q  &HRM_left_index_tap_v1B_TKZ J  &HRM_left_index_tap_v1B_TKZ U  &HRM_left_index_tap_v1B_TKZ L  &HRM_left_index_tap_v1B_TKZ RA(U)  &trans  &trans  &trans  &trans  &trans  &trans
                &HRM_left_index_tap_v1B_TKZ SEMI  &HRM_left_index_pinky_v1B_TKZ LGUI A  &HRM_left_index_ringv1_TKZ LALT O  &HRM_left_index_middy_v1B_TKZ LCTRL I  &none  &HRM_left_index_tap_v1B_TKZ RA(O)  &trans  &kp H  &kp T  &kp S  &kp R  &trans
                &HRM_left_index_tap_v1B_TKZ GRAVE  &HRM_left_index_tap_v1B_TKZ SQT  &HRM_left_index_tap_v1B_TKZ DOT  &HRM_left_index_tap_v1B_TKZ COMMA  &HRM_left_index_tap_v1B_TKZ M  &HRM_left_index_tap_v1B_TKZ RA(A)  &HRM_left_index_tap_v1B_TKZ ESC  &trans  &trans  &trans  &trans  &trans  &trans  &trans  &trans  &trans  &trans  &trans
                &trans  &trans  &HRM_left_index_tap_v1B_TKZ FSLH  &HRM_left_index_tap_v1B_TKZ MINUS  &HRM_left_index_tap_v1B_TKZ EQUAL  &HRM_left_index_tap_v1B_TKZ E  &trans  &trans  &trans  &trans  &trans  &trans  &trans  &trans  &trans  &trans
            >;
        };

        layer_RightIndex {
            bindings = <
                &trans  &trans  &trans  &trans  &trans  &HRM_right_index_tap_v1B_TKZ F6  &HRM_right_index_tap_v1B_TKZ F7  &HRM_right_index_tap_v1B_TKZ F8  &HRM_right_index_tap_v1B_TKZ F9  &HRM_right_index_tap_v1B_TKZ F10
                &trans  &trans  &trans  &trans  &trans  &trans  &HRM_right_index_tap_v1B_TKZ N6  &HRM_right_index_tap_v1B_TKZ N7  &HRM_right_index_tap_v1B_TKZ N8  &HRM_right_index_tap_v1B_TKZ N9  &HRM_right_index_tap_v1B_TKZ N0  &trans
                &trans  &trans  &trans  &trans  &trans  &trans  &HRM_right_index_tap_v1B_TKZ B  &HRM_right_index_tap_v1B_TKZ P  &HRM_right_index_tap_v1B_TKZ F  &HRM_right_index_tap_v1B_TKZ W  &HRM_right_index_tap_v1B_TKZ X  &HRM_right_index_tap_v1B_TKZ BSLH
                &trans  &kp A  &kp O  &kp I  &kp N  &trans  &HRM_right_index_tap_v1B_TKZ K  &none  &HRM_right_index_middy_v1B_TKZ RCTRL T  &HRM_right_index_ring_v1B_TKZ LALT S  &HRM_right_index_pinky_v1B_TKZ RGUI R  &HRM_right_index_tap_v1B_TKZ Y
                &trans  &trans  &trans  &trans  &trans  &trans  &trans  &trans  &trans  &trans  &trans  &trans  &HRM_right_index_tap_v1B_TKZ Z  &HRM_right_index_tap_v1B_TKZ D  &HRM_right_index_tap_v1B_TKZ G  &HRM_right_index_tap_v1B_TKZ C  &HRM_right_index_tap_v1B_TKZ V  &trans
                &trans  &trans  &trans  &trans  &trans  &trans  &trans  &trans  &trans  &trans  &trans  &trans  &HRM_right_index_tap_v1B_TKZ LBKT  &HRM_right_index_tap_v1B_TKZ RBKT  &trans  &trans
            >;
        };

        layer_RightMiddy {
            bindings = <
                &trans  &trans  &trans  &trans  &trans  &HRM_right_middy_tap_v1B_TKZ F6  &HRM_right_middy_tap_v1B_TKZ F7  &HRM_right_middy_tap_v1B_TKZ F8  &HRM_right_middy_tap_v1B_TKZ F9  &HRM_right_middy_tap_v1B_TKZ F10
                &trans  &trans  &trans  &trans  &trans  &trans  &HRM_right_middy_tap_v1B_TKZ N6  &HRM_right_middy_tap_v1B_TKZ N7  &HRM_right_middy_tap_v1B_TKZ N8  &HRM_right_middy_tap_v1B_TKZ N9  &HRM_right_middy_tap_v1B_TKZ N0  &trans
                &trans  &trans  &trans  &trans  &trans  &trans  &HRM_right_middy_tap_v1B_TKZ B  &HRM_right_middy_tap_v1B_TKZ P  &HRM_right_middy_tap_v1B_TKZ F  &HRM_right_middy_tap_v1B_TKZ W  &HRM_right_middy_tap_v1B_TKZ X  &HRM_right_middy_tap_v1B_TKZ BSLH
                &trans  &kp A  &kp O  &kp I  &kp N  &trans  &HRM_right_middy_tap_v1B_TKZ K  &HRM_right_middy_index_v1B_TKZ RSHFT H  &none  &HRM_right_middy_ring_v1B_TKZ LALT S  &HRM_right_middy_pinky_v1B_TKZ RGUI R  &HRM_right_middy_tap_v1B_TKZ Y
                &trans  &trans  &trans  &trans  &trans  &trans  &trans  &trans  &trans  &trans  &trans  &trans  &HRM_right_middy_tap_v1B_TKZ Z  &HRM_right_middy_tap_v1B_TKZ D  &HRM_right_middy_tap_v1B_TKZ G  &HRM_right_middy_tap_v1B_TKZ C  &HRM_right_middy_tap_v1B_TKZ V  &trans
                &trans  &trans  &trans  &trans  &trans  &trans  &trans  &trans  &trans  &trans  &trans  &trans  &HRM_right_middy_tap_v1B_TKZ LBKT  &HRM_right_middy_tap_v1B_TKZ RBKT  &trans  &trans
            >;
        };

        layer_RightRingy {
            bindings = <
                &trans  &trans  &trans  &trans  &trans  &HRM_right_ring_tap_v1B_TKZ F6  &HRM_right_ring_tap_v1B_TKZ F7  &HRM_right_ring_tap_v1B_TKZ F8  &HRM_right_ring_tap_v1B_TKZ F9  &HRM_right_ring_tap_v1B_TKZ F10
                &trans  &trans  &trans  &trans  &trans  &trans  &HRM_right_ring_tap_v1B_TKZ N6  &HRM_right_ring_tap_v1B_TKZ N7  &HRM_right_ring_tap_v1B_TKZ N8  &HRM_right_ring_tap_v1B_TKZ N9  &HRM_right_ring_tap_v1B_TKZ N0  &trans
                &trans  &trans  &trans  &trans  &trans  &trans  &HRM_right_ring_tap_v1B_TKZ B  &HRM_right_ring_tap_v1B_TKZ P  &HRM_right_ring_tap_v1B_TKZ F  &HRM_right_ring_tap_v1B_TKZ W  &HRM_right_ring_tap_v1B_TKZ X  &HRM_right_ring_tap_v1B_TKZ BSLH
                &trans  &kp A  &kp O  &kp I  &kp N  &trans  &HRM_right_ring_tap_v1B_TKZ K  &HRM_right_ring_index_v1B_TKZ RSHFT H  &HRM_right_ring_middy_v1B_TKZ RCTRL T  &none  &HRM_right_ring_pinky_v1B_TKZ RGUI R  &HRM_right_ring_tap_v1B_TKZ Y
                &trans  &trans  &trans  &trans  &trans  &trans  &trans  &trans  &trans  &trans  &trans  &trans  &HRM_right_ring_tap_v1B_TKZ Z  &HRM_right_ring_tap_v1B_TKZ D  &HRM_right_ring_tap_v1B_TKZ G  &HRM_right_ring_tap_v1B_TKZ C  &HRM_right_ring_tap_v1B_TKZ V  &trans
                &trans  &trans  &trans  &trans  &trans  &trans  &trans  &trans  &trans  &trans  &trans  &trans  &HRM_right_ring_tap_v1B_TKZ LBKT  &HRM_right_ring_tap_v1B_TKZ RBKT  &trans  &trans
            >;
        };

        layer_RightPinky {
            bindings = <
                &trans  &trans  &trans  &trans  &trans  &HRM_right_pinky_tap_v1B_TKZ F6  &HRM_right_pinky_tap_v1B_TKZ F7  &HRM_right_pinky_tap_v1B_TKZ F8  &HRM_right_pinky_tap_v1B_TKZ F9  &HRM_right_pinky_tap_v1B_TKZ F10
                &trans  &trans  &trans  &trans  &trans  &trans  &HRM_right_pinky_tap_v1B_TKZ N6  &HRM_right_pinky_tap_v1B_TKZ N7  &HRM_right_pinky_tap_v1B_TKZ N8  &HRM_right_pinky_tap_v1B_TKZ N9  &HRM_right_pinky_tap_v1B_TKZ N0  &trans
                &trans  &trans  &trans  &trans  &trans  &trans  &HRM_right_pinky_tap_v1B_TKZ B  &HRM_right_pinky_tap_v1B_TKZ P  &HRM_right_pinky_tap_v1B_TKZ F  &HRM_right_pinky_tap_v1B_TKZ W  &HRM_right_pinky_tap_v1B_TKZ X  &HRM_right_pinky_tap_v1B_TKZ BSLH
                &trans  &kp A  &kp O  &kp I  &kp N  &trans  &HRM_right_pinky_tap_v1B_TKZ K  &HRM_right_pinky_index_v1B_TKZ RSHFT H  &HRM_right_pinky_middy_v1B_TKZ RCTRL T  &HRM_right_pinky_ring_v1B_TKZ LALT S  &none  &HRM_right_pinky_tap_v1B_TKZ Y
                &trans  &trans  &trans  &trans  &trans  &trans  &trans  &trans  &trans  &trans  &trans  &trans  &HRM_right_pinky_tap_v1B_TKZ Z  &HRM_right_pinky_tap_v1B_TKZ D  &HRM_right_pinky_tap_v1B_TKZ G  &HRM_right_pinky_tap_v1B_TKZ C  &HRM_right_pinky_tap_v1B_TKZ V  &trans
                &trans  &trans  &trans  &trans  &trans  &trans  &trans  &trans  &trans  &trans  &trans  &trans  &HRM_right_pinky_tap_v1B_TKZ LBKT  &HRM_right_pinky_tap_v1B_TKZ RBKT  &trans  &trans
            >;
        };

        layer_Cursor {
            bindings = <
                &none  &none  &none  &none  &none  &none  &none  &none  &none  &none
                &none  &kp ESC  &kp INS  &kp LS(TAB)  &kp DEL  &kp LS(LG(S))  &none  &none  &none  &none  &none  &none
                &none  &kp RET  &kp SPACE  &kp TAB  &kp BSPC  &kp LC(X)  &kp LC(X)  &kp LS(TAB)  &kp LC(Z)  &kp LC(Y)  &kp TAB  &none
                &sk LSHFT  &kp LGUI  &kp LALT  &kp LCTRL  &kp LSHFT  &kp LC(C)  &kp LC(C)  &kp LEFT  &kp UP  &kp DOWN  &kp RIGHT  &sk RSHFT
                &kp LC(L)  &kp LC(A)  &cur_SELECT_LINE_v1_TKZ  &cur_SELECT_WORD_v1_TKZ  &kp LC(F)  &kp LC(V)  &none  &none  &none  &cur_SELECT_NONE_v1_TKZ  &cur_EXTEND_LINE_v1_TKZ  &cur_EXTEND_WORD_v1_TKZ  &kp LC(V)  &kp HOME  &kp PG_UP  &kp PG_DN  &kp END  &kp LC(L)
                &kp LC(K)  &kp LC(Z)  &kp LC(Y)  &kp LC(LS(G))  &kp LC(G)  &none  &none  &none  &kp LC(A)  &cur_SELECT_LINE_v1_TKZ  &cur_SELECT_WORD_v1_TKZ  &kp LC(F)  &kp LC(LS(G))  &kp LC(G)  &kp LC(H)  &kp LC(K)
            >;
        };

        layer_Symbol {
            bindings = <
               &none          &none         &none                 &none          &none                                                                                                        &none        &none      &none     &none   &none
               &none      &kp GRAVE    &kp LS(N9)            &kp LS(N0)       &kp SEMI     &kp COMMA                                                                    &none                 &none        &none      &none     &none   &none
          &kp LS(N1)       &kp LBKT  &kp LS(LBKT)          &kp LS(RBKT)       &kp RBKT  &kp LS(FSLH)                                                                  &kp DOT               &kp DEL  &kp LS(TAB)    &kp INS   &kp ESC   &none
          &kp LS(N3)     &kp LS(N6)     &kp EQUAL         &kp LS(MINUS)     &kp LS(N4)    &kp LS(N8)                                                                &kp COMMA              &kp BSPC      &kp TAB  &kp SPACE   &kp RET   &none
       &kp LS(GRAVE)  &kp LS(COMMA)  &kp LS(BSLH)             &kp MINUS    &kp LS(DOT)      &kp FSLH    &kp BSLH       &kp DOT  &kp LS(N8)   &none   &none   &none   &kp SEMI  &kp LS(SINGLE_QUOTE)      &kp SQT  &kp GRAVE  &kp BSLH   &none
 &symb_dotdot_v1_TKZ     &kp LS(N7)       &kp SQT  &kp LS(SINGLE_QUOTE)  &kp LS(EQUAL)                &kp LS(N5)  &kp LS(SEMI)  &kp LS(N2)   &none   &none   &none                        &sk RSHFT    &sk RCTRL   &sk RALT  &sk RGUI   &none
            >;
        };

        layer_Mouse {
            bindings = <
  &none           &none                &none                &none                &none                                                                                                                     &none                &none                &none            &none     &none
  &none           &none                &none                &none                &none           &none                                                                                &none                &none                &none                &none            &none     &none
  &none           &none       &msc SCRL_LEFT         &mmv MOVE_UP      &msc SCRL_RIGHT           &none                                                                       &msc SCRL_LEFT            &mkp LCLK            &mkp MCLK            &mkp RCLK  &msc SCRL_RIGHT     &none
  &none    &msc SCRL_UP       &mmv MOVE_LEFT       &mmv MOVE_DOWN      &mmv MOVE_RIGHT    &msc SCRL_UP                                                                         &msc SCRL_UP  &mo LAYER_MouseFast  &mo LAYER_MouseWarp  &mo LAYER_MouseSlow        &kp K_APP  &mkp MB4
  &none  &msc SCRL_DOWN  &mo LAYER_MouseSlow  &mo LAYER_MouseWarp  &mo LAYER_MouseFast  &msc SCRL_DOWN  &mkp MCLK  &kp K_APP  &mkp MB5  &kp LC(X)  &kp LC(C)  &kp LC(V)  &msc SCRL_DOWN       &mmv MOVE_LEFT         &mmv MOVE_UP       &mmv MOVE_DOWN  &mmv MOVE_RIGHT  &mkp MB5
  &none           &none            &kp LC(X)            &kp LC(C)            &kp LC(V)                  &mkp LCLK  &mkp RCLK  &mkp MB4      &none      &none          &none                            &kp RSHFT            &kp RCTRL             &kp RALT         &kp RGUI     &none
            >;
        };

        layer_MouseSlow {
            bindings = <
 &trans  &trans  &trans  &trans  &trans                                                                  &trans  &trans  &trans  &trans  &trans
 &trans  &trans  &trans  &trans  &trans  &trans                                                  &trans  &trans  &trans  &trans  &trans  &trans
 &trans  &trans  &trans  &trans  &trans  &trans                                                  &trans  &trans  &trans  &trans  &trans  &trans
 &trans  &trans  &trans  &trans  &trans  &trans                                                  &trans  &trans  &trans  &trans  &trans  &trans
 &trans  &trans  &trans  &trans  &trans  &trans  &trans  &trans  &trans  &trans  &trans  &trans  &trans  &trans  &trans  &trans  &trans  &trans
 &trans  &trans  &trans  &trans  &trans          &trans  &trans  &trans  &trans  &trans  &trans          &trans  &trans  &trans  &trans  &trans
            >;
        };

        layer_MouseFast {
            bindings = <
 &trans  &trans  &trans  &trans  &trans                                                                  &trans  &trans  &trans  &trans  &trans
 &trans  &trans  &trans  &trans  &trans  &trans                                                  &trans  &trans  &trans  &trans  &trans  &trans
 &trans  &trans  &trans  &trans  &trans  &trans                                                  &trans  &trans  &trans  &trans  &trans  &trans
 &trans  &trans  &trans  &trans  &trans  &trans                                                  &trans  &trans  &trans  &trans  &trans  &trans
 &trans  &trans  &trans  &trans  &trans  &trans  &trans  &trans  &trans  &trans  &trans  &trans  &trans  &trans  &trans  &trans  &trans  &trans
 &trans  &trans  &trans  &trans  &trans          &trans  &trans  &trans  &trans  &trans  &trans          &trans  &trans  &trans  &trans  &trans
            >;
        };

        layer_MouseWarp {
            bindings = <
 &trans  &trans  &trans  &trans  &trans                                                                  &trans  &trans  &trans  &trans  &trans
 &trans  &trans  &trans  &trans  &trans  &trans                                                  &trans  &trans  &trans  &trans  &trans  &trans
 &trans  &trans  &trans  &trans  &trans  &trans                                                  &trans  &trans  &trans  &trans  &trans  &trans
 &trans  &trans  &trans  &trans  &trans  &trans                                                  &trans  &trans  &trans  &trans  &trans  &trans
 &trans  &trans  &trans  &trans  &trans  &trans  &trans  &trans  &trans  &trans  &trans  &trans  &trans  &trans  &trans  &trans  &trans  &trans
 &trans  &trans  &trans  &trans  &trans          &trans  &trans  &trans  &trans  &trans  &trans          &trans  &trans  &trans  &trans  &trans
            >;
        };

        layer_Magic {
            bindings = <
                 &none            &none             &none            &none            &none                                                                                      &none   &none   &none  &bt BT_CLR  &bt BT_CLR_ALL
 &to LAYER_Base            &none  &to LAYER_Typing            &none            &none  &none                                                         &none   &none   &none   &none       &none           &none
                 &none  &rgb_ug RGB_SPI   &rgb_ug RGB_SAI  &rgb_ug RGB_HUI  &rgb_ug RGB_BRI      &rgb_ug RGB_TOG                                                         &none   &none   &none   &none       &none           &none
           &bootloader  &rgb_ug RGB_SPD   &rgb_ug RGB_SAD  &rgb_ug RGB_HUD  &rgb_ug RGB_BRD      &rgb_ug RGB_EFF                                                         &none   &none   &none   &none       &none     &bootloader
            &sys_reset            &none             &none            &none            &none                &none   &bt_2   &bt_3         &none   &none   &none   &none   &none   &none   &none   &none       &none      &sys_reset
                 &none            &none             &none            &none            &none                        &bt_0   &bt_1  &out OUT_USB   &none   &none   &none           &none   &none   &none       &none           &none
            >;
        };

        layer_Numbers {
            bindings = <
  &none       &none     &none     &none      &none                                                                                       &none      &none      &none       &none   &none
  &none       &none     &none     &none      &none   &none                                                                   &none       &none      &none      &none       &none   &none
  &none       &none     &none     &none      &none   &none                                                                   &none   &kp N7  &kp N8  &kp N9       &none   &none
  &none  &kp LS(N6)  &kp LALT  &kp LGUI  &kp LSHFT   &none                                                                   &none   &kp N4  &kp N5  &kp N6       &none   &none
  &none       &none     &none     &none      &none   &none   &none   &none   &none  &kp LS(SEMI)  &kp LS(EQUAL)    &kp DOT   &none   &kp N1  &kp N2  &kp N3       &none   &none
  &none       &none     &none     &none      &none           &none   &none   &none     &kp MINUS      &kp COMMA  &kp N0          &kp LS(N9)   &kp LBKT   &kp RBKT  &kp LS(N0)   &none
            >;
        };

        layer_Function {
            bindings = <
  &none      &none     &none     &none      &none                                                                                                                                       &none     &none       &none       &none   &none
  &none      &none     &none     &none      &none  &kp LA(N3)                                                                                                          &kp LA(N7)       &none     &none       &none       &none   &none
  &none      &none     &none     &none      &none  &kp LA(N2)                                                                                                          &kp LA(N6)      &kp F7    &kp F8      &kp F9     &kp F10   &none
  &none  &kp LCTRL  &kp LALT  &kp LGUI  &kp LSHFT  &kp LA(N1)                                                                                                          &kp LA(N5)      &kp F4    &kp F5      &kp F6     &kp F11   &none
  &none      &none     &none     &none      &none  &kp LA(N0)   &none   &none   &none  &kp LG(LS(LA(LC(D))))  &kp LC(LA(LS(LG(P))))  &kp LC(LA(LS(LG(Q))))  &kp LC(LA(LS(LG(F))))      &kp F1    &kp F2      &kp F3     &kp F12   &none
  &none      &none     &none     &none      &none               &none   &none   &none  &kp LC(LA(LS(LG(V))))  &kp LC(LA(LS(LG(C))))  &kp LG(LS(LA(LC(Z))))                         &kp C_PREV  &kp C_PP  &kp C_NEXT  &kp C_MUTE   &none
            >;
        };

        layer_Gaming {
            bindings = <
 &kp F1     &kp F2  &kp F3  &kp F4  &kp F5                                                                           &kp F6    &kp F7     &kp F8   &kp F9  &kp F10
  &none      &none   &none   &none   &none   &none                                                          &none     &none    &kp UP      &none  &kp F11  &kp F12
  &none      &none   &none   &none   &none   &none                                                          &none  &kp LEFT  &kp DOWN  &kp RIGHT    &none    &none
  &none      &none   &kp Q   &kp W   &kp E   &kp R                                                          &none     &kp U     &kp I      &kp O    &kp P    &none
  &none  &kp LSHFT   &kp A   &kp S   &kp D   &kp F  &kp ESC    &none   &none   &none   &kp DEL    &kp RET   &none     &kp J     &kp K      &kp L    &none    &none
  &none  &kp RCTRL   &kp Z   &kp X   &kp C            &kp M  &kp TAB   &none   &none  &kp BSPC  &kp SPACE             &none     &none      &none    &none    &none
            >;
        };

        layer_Aerospace {
            bindings = <
  &none   &none   &none                      &none                      &none                                                                                                                                                                    &none                   &none                   &none                   &none                   &none
  &none   &none   &none                      &none                      &none  &kp LC(LA(LS(LG(SEMI))))                                                                                                     &kp LG(LA(LS(N1)))      &kp LG(LA(LS(N2)))      &kp LG(LA(LS(N3)))      &kp LG(LA(LS(N4)))      &kp LG(LA(LS(N5)))      &kp LG(LA(LS(N6)))
  &none   &none   &none                      &none                      &none                     &none                                                                                                 &kp LC(LA(LS(LG(N1))))  &kp LC(LA(LS(LG(N2))))  &kp LC(LA(LS(LG(N3))))  &kp LC(LA(LS(LG(N4))))  &kp LC(LA(LS(LG(N5))))  &kp LC(LA(LS(LG(N6))))
  &none   &none   &none                      &none                      &none                     &none                                                                                                                  &none   &kp LC(LA(LS(LG(H))))   &kp LC(LA(LS(LG(J))))   &kp LA(LS(LC(LG(K))))   &kp LC(LA(LS(LG(L))))                   &none
  &none   &none   &none                      &none                      &none                     &none   &none   &none   &none  &kp LC(LA(LS(LG(A))))  &kp LC(LS(LA(LG(E))))                    &none                   &none       &kp LA(LS(LG(H)))       &kp LG(LA(LS(J)))       &kp LS(LA(LG(K)))       &kp LG(LA(LS(L)))                   &none
  &none   &none   &none  &kp LC(LA(LS(LG(MINUS))))  &kp LS(LC(LA(LG(EQUAL))))                             &none   &none   &none  &kp LC(LA(LS(LG(B))))                  &none  &kp LC(LA(LS(LG(TAB))))                               &kp LG(LA(LS(D)))       &kp LG(LA(LS(G)))       &kp LG(LA(LS(C)))       &kp LG(LA(LS(V)))                   &none
            >;
        };

    };
};
